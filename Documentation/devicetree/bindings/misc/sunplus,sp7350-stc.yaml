## Documentation/devicetree/bindings/misc/sunplus,sp7350-stc.yaml
```yaml
# SPDX-License-Identifier: (GPL-2.0-only OR BSD-2-Clause)
# Copyright (C) Sunplus Co., Ltd. 2024
%YAML 1.2
---
$id: http://devicetree.org/schemas/misc/sunplus,sp7350-stc.yaml#
$schema: http://devicetree.org/meta-schemas/core.yaml#

title: Sunplus SoCs STC

maintainers:
  - XianTao Hu <xt.hu@sunmedia.com.cn>

properties:
  compatible:
    const: sunplus,sp7350-stc

  reg:
    maxItems: 1

  clocks:
    maxItems: 1

  clock-names:
    const: clk_sys

required:
  - compatible
  - reg
  - clocks
  - clock-names

additionalProperties: false

examples:
  - |
    #include <dt-bindings/clock/sp-sp7350.h>
    soc {
      #address-cells = <2>;
      #size-cells = <2>;
      stc: stc@f8800b80 {
        compatible = "sunplus,sp7350-stc";
        reg = <0x00 0xf8800b80 0x00 0x14>;
        clocks = <&clkc SYSAO>;
        clock-names = "clk_sys";
      };
    };
...
```

## Documentation/devicetree/bindings/misc/sunplus,sp7350-timer.yaml
```yaml
# SPDX-License-Identifier: (GPL-2.0-only OR BSD-2-Clause)
# Copyright (C) Sunplus Co., Ltd. 2021
%YAML 1.2
---
$id: http://devicetree.org/schemas/misc/sunplus,sp7350-timer.yaml#
$schema: http://devicetree.org/meta-schemas/core.yaml#

title: Sunplus SoCs Timer

maintainers:
  - XianTao Hu <xt.hu@sunmedia.com.cn>

properties:
  compatible:
    const: sunplus,sp7350-timer

  reg:
    maxItems: 1

  interrupts:
    maxItems: 1

required:
  - compatible
  - reg
  - interrupts

additionalProperties: false

examples:
  - |
    #include <dt-bindings/interrupt-controller/arm-gic.h>
    soc {
      stc {
        #address-cells = <2>;
        #size-cells = <2>;
        stc_timer0: timer0@f8800ba4 {
          compatible = "sunplus,sp7350-timer";
          reg = <0x0 0xf8800ba4 0x0 0xc>;
          interrupt-parent = <&gic>;
          interrupts = <GIC_SPI 129 IRQ_TYPE_EDGE_RISING>;
        };
      };
    };
...
```

## Documentation/devicetree/bindings/mmc/sunplus,sp7350-mmc.yaml
```yaml
# SPDX-License-Identifier: (GPL-2.0-only OR BSD-2-Clause)
# Copyright (C) Sunplus Ltd. Co. 2024
%YAML 1.2
---
$id: http://devicetree.org/schemas/mmc/sunplus,sp7350-mmc.yaml#
$schema: http://devicetree.org/meta-schemas/core.yaml#

title: Sunplus MMC Controller

maintainers:
  - Tony Huang <tonyhuang.sunplus@gmail.com>

allOf:
  - $ref: mmc-controller.yaml

properties:
  compatible:
    enum:
      - sunplus,sp7350-emmc

  reg:
    maxItems: 3

  interrupts:
    maxItems: 1

  clocks:
    maxItems: 1

  resets:
    maxItems: 1

required:
  - compatible
  - reg
  - interrupts
  - clocks
  - resets

unevaluatedProperties: false

examples:
  - |
    #include <dt-bindings/interrupt-controller/irq.h>
    #include <dt-bindings/interrupt-controller/arm-gic.h>  
    #include <dt-bindings/clock/sp-sp7350.h>
    #include <dt-bindings/reset/sp-sp7350.h>
    mmc0: mmc@f8003b00 {
        compatible = "sunplus,sp7350-emmc";
        reg = <0xf8003b00 0x180>, <0xf8803280 0x80>, <0xf8803354 0x0C>;
        interrupt-parent = <&gic>;
        interrupts = <GIC_SPI 17 IRQ_TYPE_LEVEL_HIGH>;
        clocks = <&clkc CARD_CTL0>;
        resets = <&rstc RST_CARD_CTL0>;
        pinctrl-names = "default";
        pinctrl-0 = <&emmc_pins>;
        bus-width = <8>;
        non-removable;
        disable-wp;
        cap-mmc-highspeed;
        no-sdio;
        no-sd;
    };
```

## Documentation/devicetree/bindings/mmc/sunplus,sp7350-sd.yaml
```yaml
# SPDX-License-Identifier: (GPL-2.0-only OR BSD-2-Clause)
# Copyright (C) Sunplus Ltd. Co. 2024
%YAML 1.2
---
$id: http://devicetree.org/schemas/mmc/sunplus,sp7350-sd.yaml#
$schema: http://devicetree.org/meta-schemas/core.yaml#

title: Sunplus sd Controller

maintainers:
  - Li-hao Kuo <lhjeff911@gmail.com>

allOf:
  - $ref: mmc-controller.yaml

properties:
  compatible:
    enum:
      - sunplus,sp7350-sd
      - sunplus,sp7350-loscr-sd
      - sunplus,sp7350-1v8-sdio

  reg:
    maxItems: 1

  interrupts:
    maxItems: 1

  clocks:
    maxItems: 1

  resets:
    maxItems: 1

required:
  - compatible
  - reg
  - interrupts
  - clocks
  - resets

unevaluatedProperties: false

examples:
  - |
    #include <dt-bindings/interrupt-controller/irq.h>
    #include <dt-bindings/interrupt-controller/arm-gic.h>  
    #include <dt-bindings/clock/sp-sp7350.h>
    #include <dt-bindings/reset/sp-sp7350.h>
    mmc1: mmc@f8003e80 {
        compatible = "sunplus,sp7350-sd";
        reg = <0xf8003e80 0x180>;
        interrupt-parent = <&gic>;
        interrupts = <GIC_SPI 16 IRQ_TYPE_LEVEL_HIGH>;
        clocks = <&clkc CARD_CTL1>;
        resets = <&rstc RST_CARD_CTL1>;
        pinctrl-names = "default";
        pinctrl-0 = <&sdcard_pins &sdcard_cd_pins>;
        bus-width = <4>;
        non-removable;
        disable-wp;
        cap-mmc-highspeed;
        no-sdio;
        no-mmc;
    };
```

## Documentation/devicetree/bindings/mtd/sunplus,sp7350-para-nand.yaml
```yaml
# SPDX-License-Identifier: (GPL-2.0-only OR BSD-2-Clause)
# Copyright (C) Sunplus Co., Ltd. 2024
%YAML 1.2
---
$id: http://devicetree.org/schemas/mtd/sunplus,sp7350-para-nand.yaml#
$schema: http://devicetree.org/meta-schemas/core.yaml#

title: Sunplus SoCs Parallel Nand Controller

maintainers:
  - XianTao Hu <xt.hu@sunmedia.com.cn>

properties:
  compatible:
    const: sunplus,sp7350-para-nand

  reg:
    items:
      - description: parallel nand controller control registers regions
      - description: parallel nand controller SRAM regions

  interrupts:
    maxItems: 1

  clocks:
    maxItems: 1

  resets:
    maxItems: 1

  dmas:
    maxItems: 1

  dma-names:
    maxItems: 1

required:
  - compatible
  - reg
  - interrupts
  - clocks
  - resets
  - dmas
  - dma-names

additionalProperties: false

examples:
  - |
    #include <dt-bindings/interrupt-controller/arm-gic.h>
    #include <dt-bindings/clock/sp-sp7350.h>
    #include <dt-bindings/reset/sp-sp7350.h>
    soc {
      #address-cells = <2>;
      #size-cells = <2>;
      paranand0: paranand@f8120000 {
        compatible = "sunplus,sp7350-para-nand";
        reg = <0x0 0xf8120000 0x0 0x3000>, <0x0 0xfb000000 0x0 0x4000000>;
        interrupt-parent = <&gic>;
        interrupts = <GIC_SPI 71 IRQ_TYPE_LEVEL_HIGH>;
        clocks = <&clkc PNAND>;
        resets = <&rstc RST_PNAND>;
        dmas = <&dmac 2>;
        dma-names = "rxtx";
      };
    };
...
```

## Documentation/devicetree/bindings/mtd/sunplus,spinand.yaml
```yaml
# SPDX-License-Identifier: (GPL-2.0-only OR BSD-2-Clause)
# Copyright (C) Sunplus Co., Ltd. 2024
%YAML 1.2
---
$id: http://devicetree.org/schemas/mtd/sunplus,spinand.yaml#
$schema: http://devicetree.org/meta-schemas/core.yaml#

title: Sunplus SPI-NAND Controller

maintainers:
  - Cheng Chung Ho <cc.ho@sunplus.com>

description:
  Sunplus SPI-NAND Controller DT Binding

properties:
  compatible:
    const: sunplus,sp7350-para-nand

  reg:
    maxItems: 2

  reg-names:
    maxItems: 2

  interrupts:
    maxItems: 2

  interrupt-names:
    maxItems: 2

  clocks:
    maxItems: 2

  clock-names:
    maxItems: 2

  resets:
    maxItems: 2

  reset-names:
    maxItems: 2

required:
  - compatible
  - reg
  - reg-names
  - interrupts
  - interrupt-names
  - clocks
  - clock-names
  - resets
  - reset-names

additionalProperties: false

examples:
  - |
    #include <dt-bindings/interrupt-controller/irq.h>
    #include <dt-bindings/interrupt-controller/arm-gic.h>
    #include <dt-bindings/clock/sp-sp7350.h>
    #include <dt-bindings/reset/sp-sp7350.h>

    spinand0: spinand@f8002b80 {
        compatible = "sunplus,sp7350-spi-nand";
        reg = <0x0 0xf8002b80 0x0 0x60>, <0x0 0xf8101000 0x0 0x30>;
        reg-names = "nand", "bch";
        interrupt-parent = <&gic>;
        interrupts = <GIC_SPI 23 IRQ_TYPE_LEVEL_HIGH>, <GIC_SPI 24 IRQ_TYPE_LEVEL_HIGH>;
        interrupt-names = "int_nand", "int_bch";
        clocks = <&clkc SPIND>, <&clkc BCH>;
        clock-names = "clk_nand", "clk_bch";
        resets = <&rstc RST_SPIND>, <&rstc RST_BCH>;
        reset-names = "rst_nand", "rst_bch";
    };
...
```

## Documentation/devicetree/bindings/net/wireless/android,bcmdhd_wlan.yaml
```yaml
# SPDX-License-Identifier: (GPL-2.0-only OR BSD-2-Clause)
# Copyright (C) Sunplus Ltd. Co. 2021
%YAML 1.2
---
$id: http://devicetree.org/schemas/net/wireless/android,bcmdhd_wlan.yaml#
$schema: http://devicetree.org/meta-schemas/core.yaml#

title: AP6256 driver in Sunplus SoCs

maintainers:
  - Li-hao Kuo <lhjeff911@gmail.com>

properties:
  compatible:
    enum:
      - android,bcmdhd_wlan

  interrupts:
    maxItems: 1
    description: Out-of-band (OOB) IRQ line for waking up the host
      in response to WLAN activity. This corresponds to the HOST_WAKE
      line into the chip.

required:
  - compatible

additionalProperties: false

examples:
  - |
    #include <dt-bindings/interrupt-controller/irq.h>
    #include <dt-bindings/interrupt-controller/arm-gic.h>
      wifi {
        compatible = "android,bcmdhd_wlan";
        interrupt-parent = <&gic>;
        interrupts = <GIC_SPI 0 IRQ_TYPE_LEVEL_HIGH>;
      };
```

## Documentation/devicetree/bindings/nvmem/sunplus,sp7350-ocotp.yaml
```yaml
# SPDX-License-Identifier: (GPL-2.0 OR BSD-2-Clause)
%YAML 1.2
---
$id: http://devicetree.org/schemas/nvmem/sunplus,sp7350-ocotp.yaml#
$schema: http://devicetree.org/meta-schemas/core.yaml#

title: On-Chip OTP Memory for Sunplus SP7350

maintainers:
  - Vincent Shih <vincent.shih@sunplus.com>

allOf:
  - $ref: nvmem.yaml#

properties:
  nvmem-layout:
    $ref: /schemas/nvmem/layouts/nvmem-layout.yaml
    description:
      Alternative to the statically defined nvmem cells, this
      container may reference more advanced (dynamic) layout
      parsers.

unevaluatedProperties: false

examples:
  - |
    #include <dt-bindings/clock/sp-sp7350.h>
    #include <dt-bindings/reset/sp-sp7350.h>

    otp0: otp@f8802380 {
      compatible = "sunplus,sp7350-ocotp";
      reg = <0x0 0xf8802380 0x0 0x60>, <0x0 0xf8802400 0x0 0x80>,
                <0x0 0xf8802480 0x0 0x18>;
      reg-names = "hb_gpio", "otprx", "otp_key";
      clocks = <&clkc OTPRX>;
      resets = <&rstc RST_OTPRX>;
      nvmem-layout {
        compatible = "fixed-layout";
        #address-cells = <1>;
        #size-cells = <1>;
        therm_calib: therm_calib@9 {
          reg = <0x9 0x3>;
        };
        mac_addr: mac-address@16 {
          #nvmem-cell-cells = <1>;
          compatible = "mac-base";
          reg = <0x16 0x6>;
        };
        disc_vol: disc_vol@2d {
          reg = <0x2d 0x1>;
        };
      };
    };
...
```

## Documentation/devicetree/bindings/phy/sunplus,sp7350-usb2-phy.yaml
```yaml
# SPDX-License-Identifier: (GPL-2.0-only OR BSD-2-Clause)
# Copyright (C) Sunplus Co., Ltd. 2024
%YAML 1.2
---
$id: http://devicetree.org/schemas/phy/sunplus,sp7350-usb2-phy.yaml#
$schema: http://devicetree.org/meta-schemas/core.yaml#

title: Sunplus SP7350 USB 2.0 PHY Controller

maintainers:
  - Vincent Shih <vincent.shih@sunplus.com>

properties:
  compatible:
    const: sunplus,sp7350-usb2-phy

  reg:
    items:
      - description: UPHY register region
      - description: MOON4 register region

  reg-names:
    items:
      - const: phy
      - const: moon4

  clocks:
    maxItems: 1

  resets:
    maxItems: 1

  interrupts:
    maxItems: 1

  nvmem-cell-names:
    description: names corresponding to the nvmem cells of disconnect voltage
    const: disc_vol

  nvmem-cells:
    description: nvmem cell address of disconnect voltage
    maxItems: 1

  "#phy-cells":
    const: 0

  sunplus,disc-vol-addr-off:
    $ref: /schemas/types.yaml#/definitions/uint32
    description: the otp address offset of disconnect voltage

required:
  - compatible
  - reg
  - reg-names
  - clocks
  - resets
  - nvmem-cell-names
  - nvmem-cells
  - "#phy-cells"
  - sunplus,disc-vol-addr-off

additionalProperties: false

examples:
  - |
    #include <dt-bindings/clock/sp-sp7350.h>
    #include <dt-bindings/reset/sp-sp7350.h>
    #include <dt-bindings/interrupt-controller/irq.h>
    #include <dt-bindings/interrupt-controller/arm-gic.h>

    soc {
      #address-cells = <2>;
      #size-cells = <2>;

      sp_uphy0: uphy@f8004a80 {
        compatible = "sunplus,sp7350-usb2-phy";
        reg = <0x0 0xf8004a80 0x0 0x80>, <0x0 0xf8800200 0x0 0x80>;
        reg-names = "phy", "moon4";
        clocks = <&clkc UPHY0>;
        resets = <&rstc RST_UPHY0>;
        interrupt-parent = <&gic>;
        interrupts = <GIC_SPI 148 IRQ_TYPE_LEVEL_HIGH>;
        nvmem-cell-names = "disc_vol";
        nvmem-cells = <&disc_vol>;
        #phy-cells = <0>;
        sunplus,disc-vol-addr-off = <0>;
      };
    };
```
