## Documentation/devicetree/bindings/pwm/sunplus,sp7350-pwm.yaml
```yaml
# SPDX-License-Identifier: (GPL-2.0-only OR BSD-2-Clause)
# Copyright (C) Sunplus Co., Ltd. 2021
%YAML 1.2
---
$id: http://devicetree.org/schemas/pwm/sunplus,sp7350-pwm.yaml#
$schema: http://devicetree.org/meta-schemas/core.yaml#

title: Sunplus SoC SP7350 PWM Controller

maintainers:
  - Hammer Hsieh <hammerh0314@gmail.com>

allOf:
  - $ref: pwm.yaml#

properties:
  compatible:
    const: sunplus,sp7350-pwm

  reg:
    maxItems: 1

  clocks:
    maxItems: 1

  '#pwm-cells':
    const: 2

unevaluatedProperties: false

required:
  - reg
  - clocks

examples:
  - |
    pwm: pwm@f8800d80 {
      compatible = "sunplus,sp7350-pwm";
      reg = <0xf8800d80 0x100>;
      clocks = <&clkc 0x86>;
      #pwm-cells = <2>;
    };
```

## Documentation/devicetree/bindings/regulator/sunplus,fixed-regulator.yaml
```yaml
# SPDX-License-Identifier: GPL-2.0-only OR BSD-2-Clause
%YAML 1.2
---
$id: http://devicetree.org/schemas/regulator/sunplus,fixed-regulator.yaml#
$schema: http://devicetree.org/meta-schemas/core.yaml#

title: Sunplus Fixed Voltage regulators

maintainers:
  - YuBo Leng <yb.leng@sunmeida.com.cn>

description:
  Any property defined as part of the core regulator binding, defined in
  regulator.yaml, can also be used. However a fixed voltage regulator is
  expected to have the regulator-min-microvolt and regulator-max-microvolt
  to be the same.

allOf:
  - $ref: regulator.yaml#
  - if:
      properties:
        compatible:
          contains:
            const: sunplus,regulator-fixed-clock
    then:
      required:
        - clocks
  - if:
      properties:
        compatible:
          contains:
            const: sunplus,regulator-fixed-domain
    then:
      required:
        - power-domains
        - required-opps
  - if:
      properties:
        compatible:
          contains:
            const: sunplus,regulator-fixed-iso
    then:
      required:
        - reg
        - sunplus,iso-selector
  - not:
      required:
        - gpio
        - gpios

properties:
  compatible:
    enum:
      - sunplus,regulator-fixed
      - sunplus,regulator-fixed-clock
      - sunplus,regulator-fixed-domain
      - sunplus,regulator-fixed-iso

  regulator-name: true
  
  reg:
    description: register address of power isolation cell(ISO).
    maxItems: 2
    
  gpio:
    description: gpio to use for enable control
    maxItems: 1

  gpios:
    maxItems: 1

  clocks:
    description:
      clock to use for enable control. This binding is only available if
      the compatible is chosen to regulator-fixed-clock. The clock binding
      is mandatory if compatible is chosen to regulator-fixed-clock.
    maxItems: 1

  power-domains:
    deprecated: true
    description:
      Power domain to use for enable control. This binding is only
      available if the compatible is chosen to regulator-fixed-domain.
    maxItems: 1

  required-opps:
    deprecated: true
    description:
      Performance state to use for enable control. This binding is only
      available if the compatible is chosen to regulator-fixed-domain. The
      power-domain binding is mandatory if compatible is chosen to
      regulator-fixed-domain.
    maxItems: 1

  startup-delay-us:
    description: startup time in microseconds

  off-on-delay-us:
    description: off delay time in microseconds

  enable-active-high:
    description:
      Polarity of GPIO is Active high. If this property is missing,
      the default assumed is Active low.
    type: boolean

  gpio-open-drain:
    description:
      GPIO is open drain type. If this property is missing then default
      assumption is false.
    type: boolean

  vin-supply:
    description: Input supply phandle.
    
  sunplus,iso-selector:
    description: Select ISO.
    $ref: /schemas/types.yaml#/definitions/uint32
    
required:
  - compatible
  - regulator-name

unevaluatedProperties: false

examples:
  - |
    #include <dt-bindings/regulator/sunplus,sp7350-regulator.h>
    
    reg_1v8: regulator-1v8 {
      compatible = "sunplus,regulator-fixed";
      regulator-name = "1v8";
      regulator-min-microvolt = <1800000>;
      regulator-max-microvolt = <1800000>;
      gpio = <&gpio1 16 0>;
      startup-delay-us = <70000>;
      enable-active-high;
      regulator-boot-on;
      gpio-open-drain;
      vin-supply = <&parent_reg>;
    };
    reg_1v8_clk: regulator-1v8-clk {
      compatible = "sunplus,regulator-fixed-clock";
      regulator-name = "1v8";
      regulator-min-microvolt = <1800000>;
      regulator-max-microvolt = <1800000>;
      clocks = <&clock1>;
      startup-delay-us = <70000>;
      enable-active-high;
      regulator-boot-on;
      vin-supply = <&parent_reg>;
    };
    reg_1v8_domain: regulator-1v8-domain {
      compatible = "sunplus,regulator-fixed-domain";
      regulator-name = "1v8";
      regulator-min-microvolt = <1800000>;
      regulator-max-microvolt = <1800000>;
      power-domains = <&domain1>;
      required-opps = <&domain1_state1>;
      startup-delay-us = <70000>;
      enable-active-high;
      regulator-boot-on;
      vin-supply = <&parent_reg>;
    };
    reg_1v8_iso: regulator-1v8-iso@f880125c {
      compatible = "sunplus,regulator-fixed-iso";
      reg = <0x00 0xf880125c 0x00 0x4>;
      regulator-name = "1v8";
      regulator-min-microvolt = <1800000>;
      regulator-max-microvolt = <1800000>;
      gpio = <&gpio1 16 0>;
      startup-delay-us = <70000>;
      enable-active-high;
      regulator-boot-on;
      gpio-open-drain;
      vin-supply = <&parent_reg>;
      sunplus,iso-selector = <SP7350_ISO_VIDEO>;
    };
...
```

## Documentation/devicetree/bindings/regulator/sunplus,sp7350-iso.yaml
```yaml
# SPDX-License-Identifier: GPL-2.0-only OR BSD-2-Clause
%YAML 1.2
---
$id: http://devicetree.org/schemas/regulator/sunplus,sp7350-iso.yaml#
$schema: http://devicetree.org/meta-schemas/core.yaml#

title: Sunplus Power Isolation

maintainers:
  - YuBo Leng <yb.leng@sunmeida.com.cn>

description:
  Sunplus Power Isolation could isolate power cells to avoid mutual interference between them.
  
properties:
  compatible:
    enum:
      - sunplus,sp7350-regulator-iso

  regulator-name: true
  
  reg:
    description: register address of power isolation cell(ISO).
    maxItems: 2
    
  sunplus,iso-selector:
    description: Select ISO.
    $ref: /schemas/types.yaml#/definitions/uint32
    
required:
  - compatible
  - reg
  - regulator-name
  - sunplus,iso-selector

unevaluatedProperties: false

examples:
  - |
    #include <dt-bindings/regulator/sunplus,sp7350-iso.h>
    reg_iso: regulator-iso@f880125c {
      compatible = "sunplus,sp7350-regulator-iso";
      reg = <0x00 0xf880125c 0x00 0x4>;
      regulator-name = "sp7350-iso";
      sunplus,iso-selector = <SP7350_ISO_VIDEO>;
    };
...
```

## Documentation/devicetree/bindings/regulator/tmi,sti8070x-regulator.yaml
```yaml
# SPDX-License-Identifier: GPL-2.0-only OR BSD-2-Clause
%YAML 1.2
---
$id: http://devicetree.org/schemas/regulator/tmi,sti8070x-regulator.yaml#
$schema: http://devicetree.org/meta-schemas/core.yaml#

title: TOLL Microelectronic(TMI) STI8070x series IIC Programmable Synchronous Buck Converter

maintainers:
  - YuBo Leng <yb.leng@sunmeida.com.cn>

description: |
  STI8070x is an I2C Programmable, high efficiency, 2.1MHz,
  Synchronous Buck converter that operates in wide input voltage
  range from 2.7V to 5.5V. The output Voltage could be programmed
  from 0.7125V to 1.5V.

properties:
  compatible:
    enum:
      - tmi,sti8070x

  reg:
    maxItems: 1

  regulator-allowed-modes:
    description: |
      buck allowed operating mode
        0: auto mode (PFM)
        1: force pwm mode
    items:
      enum: [0, 1]

  tmi,sel-pin-status:
    description: |
      set SEL pin's level. If this property is omitted, 0 is set by default.
        0:SEL pin is on low level.
        1:SEL pin is on high level.
    $ref: /schemas/types.yaml#/definitions/uint32
    enum: [0, 1]

  gpio:
    description: |
      gpio to use for enable control.
      If Enable pin is connect to a fixed power pin(like,VCC),
      this property should be omitted.
    maxItems: 1

allOf:
  - $ref: regulator.yaml#

required:
  - compatible
  - reg

unevaluatedProperties: false

examples:
  # example for STI8070A.
  - |
    i2c {
      #address-cells = <1>;
      #size-cells = <0>;

      regulator@40 {
        compatible = "tmi,sti8070x";
        reg = <0x40>;
        regulator-name = "sti8070x-buck";
        regulator-min-microvolt = <712500>;
        regulator-max-microvolt = <1500000>;
        regulator-allowed-modes = <0 1>;
        regulator-initial-mode = <1>;
        regulator-always-on;
      };
    };
  # example for STI8070B.
  - |
    i2c {
      #address-cells = <1>;
      #size-cells = <0>;

      regulator@41 {
        compatible = "tmi,sti8070x";
        reg = <0x41>;
        regulator-name = "sti8070x-buck";
        regulator-min-microvolt = <712500>;
        regulator-max-microvolt = <1500000>;
        regulator-allowed-modes = <0 1>;
        regulator-initial-mode = <1>;
        regulator-always-on;
      };
    };
  # example for STI8070C.
  - |
    i2c {
      #address-cells = <1>;
      #size-cells = <0>;

      regulator@60 {
        compatible = "tmi,sti8070x";
        reg = <0x60>;
        regulator-name = "sti8070x-buck";
        regulator-min-microvolt = <712500>;
        regulator-max-microvolt = <1500000>;
        regulator-allowed-modes = <0 1>;
        regulator-initial-mode = <1>;
        regulator-always-on;
      };
    };
```

## Documentation/devicetree/bindings/remoteproc/sunplus-rproc.yaml
```yaml
# SPDX-License-Identifier: (GPL-2.0 OR BSD-2-Clause)
%YAML 1.2
---
$id: http://devicetree.org/schemas/remoteproc/sunplus-rproc.yaml#
$schema: http://devicetree.org/meta-schemas/core.yaml#

title: Sunplus remote processor controller

description:
  This document defines the binding for the remoteproc component that loads and
  boots firmwares on the Sunplus family chipset.

maintainers:
  - Qin Jian <qinjian@sunmedia.com.cn>

properties:
  compatible:
    const: sunplus,sp-rproc

  reg:
    description:
      local_to_remote / remote_boot_addr / remote_to_local regs.
    maxItems: 3

  interrupts:
    description: remote_to_local interrupt
    maxItems: 1

  resets:
    description: remote proc reset
    minItems: 1

  memory-region:
    description:
      List of phandles to the reserved memory regions associated with the
      remoteproc device. This is variable and describes the memories shared with
      the remote processor (e.g. remoteproc firmware and carveouts, rpmsg
      vrings, ...).
      (see ../reserved-memory/reserved-memory.txt)

required:
  - compatible
  - reg
  - interrupts
  - resets

additionalProperties: false

examples:
  - |
    #include <dt-bindings/interrupt-controller/arm-gic.h>
    #include <dt-bindings/reset/sp-sp7350.h>
    cm4@f800817c {
      compatible = "sunplus,sp-rproc";
      reg = <0xf800817c 4>,
            <0xf8800250 4>,
            <0xf80081fc 4>;
      interrupts = <GIC_SPI 125 IRQ_TYPE_LEVEL_HIGH>;
      resets = <&rstc RST_CM4>;
      memory-region = <&rproc_0_reserved>, <&rproc0runaddr>, <&vdev0buffer>, <&vdev0vring0>, <&vdev0vring1>;
    };

...
```

## Documentation/devicetree/bindings/rng/sunplus,sp7350-rng.yaml
```yaml
# SPDX-License-Identifier: (GPL-2.0-only OR BSD-2-Clause)
%YAML 1.2
---
$id: http://devicetree.org/schemas/rng/sunplus,sp7350-rng.yaml#
$schema: http://devicetree.org/meta-schemas/core.yaml#

title: Sunplus SP7350 RNG

description: |
  The SP7350 hardware random number generator is a simple fixed purpose
  IP and is fully separated from other crypto functions.

maintainers:
  - Qin Jian <qinjian@sunemdia.com.cn>

properties:
  compatible:
    const: sunplus,sp7350-rng

  reg:
    maxItems: 1

  clocks:
    maxItems: 1

  resets:
    maxItems: 1

required:
  - compatible
  - reg
  - clocks
  - resets

additionalProperties: false

examples:
  - |
    #include <dt-bindings/clock/sp-sp7350.h>
    #include <dt-bindings/reset/sp-sp7350.h>
    rng@f8800264 {
      compatible = "sunplus,sp7350-rng";
      reg = <0xf8800264 0x08>;
      clocks = <&clkc PRNG>;
      resets = <&rstc RST_PRNG>;
    };

...
```

## Documentation/devicetree/bindings/rtc/sunplus,sp7350-rtc.yaml
```yaml
# SPDX-License-Identifier: (GPL-2.0-only OR BSD-2-Clause)
# Copyright (C) Sunplus Co., Ltd. 2024
%YAML 1.2
---
$id: http://devicetree.org/schemas/rtc/sunplus,sp7350-rtc.yaml#
$schema: http://devicetree.org/meta-schemas/core.yaml#

title: Sunplus SP7350 Real Time Clock controller

maintainers:
  - Vincent Shih <vincent.shih@sunplus.com>

properties:
  compatible:
    const: sunplus,sp7350-rtc

  reg:
    maxItems: 2

  reg-names:
    items:
      - const: rtc_reg
      - const: mbox_reg

  clocks:
    maxItems: 1

  resets:
    maxItems: 1

  interrupts:
    maxItems: 1

required:
  - compatible
  - reg
  - reg-names
  - clocks
  - resets
  - interrupts

additionalProperties: false

examples:
  - |
    #include <dt-bindings/clock/sp-sp7350.h>
    #include <dt-bindings/reset/sp-sp7350.h>
    #include <dt-bindings/interrupt-controller/irq.h>
    #include <dt-bindings/interrupt-controller/arm-gic.h>

    soc {
      #address-cells = <2>;
      #size-cells = <2>;

      rtc: rtc@f8801180 {
        compatible = "sunplus,sp7350-rtc";
        reg = <0x0 0xf8801180 0x0 0x30>,
                <0x0 0xf8008178 0x0 0x04>; /* mbox G258.30, cpu0 to cpu2 direct reg06 */
        reg-names = "rtc_reg","mbox_reg";
        clocks = <&clkc RTC>;
        resets = <&rstc RST_RTC>;
        interrupt-parent = <&gic>;
        interrupts = <GIC_SPI 141 IRQ_TYPE_EDGE_RISING>;
      };
    };
...
```

## Documentation/devicetree/bindings/serial/sunplus,sp7350-uart.yaml
```yaml
# SPDX-License-Identifier: (GPL-2.0-only OR BSD-2-Clause)
# Copyright (C) Sunplus Co., Ltd. 2021
%YAML 1.2
---
$id: http://devicetree.org/schemas/serial/sunplus,sp7350-uart.yaml#
$schema: http://devicetree.org/meta-schemas/core.yaml#

title: Sunplus SoC SP7350 UART Controller

maintainers:
  - Hammer Hsieh <hammerh0314@gmail.com>

allOf:
  - $ref: serial.yaml#

properties:
  compatible:
    const: sunplus,sp7350-uart

  reg:
    maxItems: 1

  interrupts:
    maxItems: 1

  clocks:
    maxItems: 1

  resets:
    maxItems: 1

required:
  - compatible
  - reg
  - interrupts
  - clocks
  - resets

additionalProperties: false

examples:
  - |
    #include <dt-bindings/interrupt-controller/arm-gic.h>
    aliases {
        serial0 = &uart0;
    };

    soc {
      #address-cells = <2>;
      #size-cells = <2>;

      uart0: serial@f8801900 {
          compatible = "sunplus,sp7350-uart";
          reg = <0x00 0xf8801900 0x00 0x80>;
          interrupt-parent = <&gic>;
          interrupts = <GIC_SPI 60 IRQ_TYPE_LEVEL_HIGH>;
          clocks = <&clkc 0x56>;
          resets = <&rstc 0x56>;
      };
    };
...
```
