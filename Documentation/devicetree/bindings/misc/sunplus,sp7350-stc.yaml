## Documentation/devicetree/bindings/pinctrl/sunplus,sp7350-pinctrl.yaml
```yaml
# SPDX-License-Identifier: (GPL-2.0-only OR BSD-2-Clause)
# Copyright (C) Sunplus Co., Ltd. 2023
%YAML 1.2
---
$id: http://devicetree.org/schemas/pinctrl/sunplus,sp7350-pinctrl.yaml#
$schema: http://devicetree.org/meta-schemas/core.yaml#

title: Sunplus SP7350 Pin Controller Device Tree Bindings

maintainers:
  - Dvorkin Dmitry <dvorkin@tibbo.com>
  - Wells Lu <wells.lu@sunplus.com>

description: |
  The Sunplus SP7350 pin controller is used to control SoC pins. Please
  refer to pinctrl-bindings.txt in this directory for details of the common
  pinctrl bindings used by client devices.


  The device node of pin controller of Sunplus SP7350 has following
  properties.

properties:
  compatible:
    const: sunplus,sp7350-pctl

  gpio-controller: true

  '#gpio-cells':
    const: 2

  reg:
    items:
      - description: Base address and length of the MOON1 registers.
      - description: Base address and length of the PAD_CTL1 registers.
      - description: Base address and length of the FIRST registers.
      - description: Base address and length of the PAD_CTL2 registers.
      - description: Base address and length of the GPIOXT registers.
      - description: Base address and length of the GPIO_AO_INT registers.
  reg-names:
    items:
      - description: Name of the MOON1 registers.
      - description: Name of the PAD_CTL1 registers.
      - description: Name of the FIRST registers.
      - description: Name of the PAD_CTL2 registers.
      - description: Name of the GPIOXT registers.
      - description: Name of the GPIO_AO_INT registers.
      
  sunplus,ms-dvio-group-0:
    description: |
      Select the voltage mode for DVIO group 0(G_MX21~G_MX27).
      "3V0" for 3.0V, "1V8" for 1.8V.

  sunplus,ms-dvio-group-1:
    description: |
      Select the voltage mode for DVIO group 1(G_MX20, G_MX28~G_MX37).
      "3V0" for 3.0V, "1V8" for 1.8V.

  sunplus,ms-dvio-ao-group-0:
    description: |
      Select the voltage mode for DVIO AO group 0(AO_MX0~AO_MX9).
      "3V0" for 3.0V, "1V8" for 1.8V.

  sunplus,ms-dvio-ao-group-1:
    description: |
      Select the voltage mode for DVIO AO group 1(AO_MX10~AO_MX19).
      "3V0" for 3.0V, "1V8" for 1.8V.

  sunplus,ms-dvio-ao-group-2:
    description: |
      Select the voltage mode for DVIO AO group 2(AO_MX20~AO_MX29).
      "3V0" for 3.0V, "1V8" for 1.8V.

patternProperties:
  '^.*$':
    if:
      type: object
    then:
      description: |
        A pinctrl node should contain at least one subnodes representing the
        pins or function-pins group available on the machine. Each subnode
        will list the pins it needs, and how they should be configured.

        Pinctrl node's client devices use subnodes for desired pin
        configuration. Client device subnodes use below standard properties.

      properties:
        pins:
          description: |
            Define pins which are used by pinctrl node's client device.

            It consists of one or more strings which represents the config
            setting for corresponding pin.
          $ref: /schemas/types.yaml#/definitions/string-array

        function:
          description: |
            Define pin-function which is used by pinctrl node's client device.
            The name should be one of string in the following enumeration.
          $ref: "/schemas/types.yaml#/definitions/string"
          enum: [
            GPIO, SPI_FLASH, EMMC, SPI_NAND, SD_CARD, SDIO, PARA_NAND,
            USB_OTG, GMAC, PWM0, PWM1, PWM2, PWM3, UART0, UART1, UART1_FC,
            UART2, UART2_FC, UART3, UADBG, UART6, UART7, I2C_COMBO0,
            I2C_COMBO1, I2C_COMBO2, I2C_COMBO3, I2C_COMBO4, I2C_COMBO5,
            I2C_COMBO6, I2C_COMBO7, I2C_COMBO8, I2C_COMBO9, SPI_MASTER0,
            SPI_MASTER1, SPI_MASTER2, SPI_MASTER3, SPI_MASTER4, SPI_SLAVE0,
            AUD_TDMTX_XCK, AUD_DAC_XCK1, AUD_DAC_XCK, AUD_AU2_DATA0,
            AUD_AU1_DATA0, AUD_AU2_CK, AUD_AU1_CK, AUD_AU_ADC_DATA0,
            AUD_ADC2_DATA0, AUD_ADC1_DATA0, AUD_TDM, SPDIF_IN, SPDIF_OUT,
            INT0, INT1, INT2, INT3, INT4, INT5, INT6, INT7, GPIO_AO_INT0,
            GPIO_AO_INT1, GPIO_AO_INT2, GPIO_AO_INT3]

        groups:
          description: |
            Define pin-group in a specified pin-function.
            The name should be one or more of string in the following enumeration.
          $ref: "/schemas/types.yaml#/definitions/string"

          enum: [
            SPI_FLASH, EMMC, SPI_NAND_X1, SPI_NAND_X2, SD_CARD, SDIO,
            PARA_NAND, USB_OTG, GMAC_RGMII, GMAC_RMII, PWM0_X1, PWM0_X2,
            PWM1_X1, PWM1_X2, PWM2_X1, PWM2_X2, PWM3_X1, PWM3_X2, UART0_X1,
            UART0_X2, UART1_X1, UART1_X2, UART1_FC_X1, UART1_FC_X2, UART2_X1,
            UART2_X2, UART2_FC_X1, UART2_FC_X2, UART3_X1, UART3_X2, UADBG,
            UART6_X1, UART6_X2, UART7, I2C_COMBO0_X1, I2C_COMBO0_X2, I2C_COMBO1,
            I2C_COMBO2_X1, I2C_COMBO2_X2, I2C_COMBO3, I2C_COMBO4, I2C_COMBO5,
            I2C_COMBO6_X1, I2C_COMBO6_X2, I2C_COMBO7_X1, I2C_COMBO7_X2, I2C_COMBO8_X1,
            I2C_COMBO8_X2, I2C_COMBO9_X1, I2C_COMBO9_X2, SPI_MASTER0_X1, SPI_MASTER0_X2,
            SPI_MASTER1_X1, SPI_MASTER1_X2, SPI_MASTER2, SPI_MASTER3_X1, SPI_MASTER3_X2,
            SPI_MASTER4, SPI_SLAVE0_X1, SPI_SLAVE0_X2, AUD_TDMTX_XCK, AUD_DAC_XCK1,
            AUD_DAC_XCK, AUD_AU2_DATA0, AUD_AU1_DATA0, AUD_AU2_CK, AUD_AU1_CK,
            AUD_AU_ADC_DATA0_X1, AUD_AU_ADC_DATA0_X2, AUD_ADC2_DATA0, AUD_ADC1_DATA0,
            AUD_TDM, SPDIF_IN_X1, SPDIF_IN_X2, SPDIF_IN_X3, SPDIF_IN_X4, SPDIF_IN_X5,
            SPDIF_IN_X6, SPDIF_OUT_X1, SPDIF_OUT_X2, SPDIF_OUT_X3, SPDIF_OUT_X4,
            SPDIF_OUT_X5, SPDIF_OUT_X6, INT0_X1, INT0_X2, INT0_X3, INT0_X4, INT0_X5,
            INT0_X6, INT0_X7, INT0_X8, INT0_X9, INT1_X1, INT1_X2, INT1_X3, INT1_X4,
            INT1_X5, INT1_X6, INT1_X7, INT1_X8, INT1_X9, INT2_X1, INT2_X2, INT2_X3,
            INT2_X4, INT2_X5, INT2_X6, INT2_X7, INT2_X8, INT2_X9, INT3_X1, INT3_X2,
            INT3_X3, INT3_X4, INT3_X5, INT3_X6, INT3_X7, INT3_X8, INT3_X9, INT4_X1,
            INT4_X2, INT4_X3, INT4_X4, INT4_X5, INT4_X6, INT4_X7, INT4_X8, INT4_X9,
            INT5_X1, INT5_X2, INT5_X3, INT5_X4, INT5_X5, INT5_X6, INT5_X7, INT5_X8,
            INT5_X9, INT6_X1, INT6_X2, INT6_X3, INT6_X4, INT6_X5, INT6_X6, INT6_X7,
            INT6_X8, INT6_X9, INT6_X10, INT6_X11, INT7_X1, INT7_X2, INT7_X3, INT7_X4,
            INT7_X5, INT7_X6, INT7_X7, INT7_X8, INT7_X9, INT7_X10, INT7_X11,
            GPIO_AO_INT0_X1, GPIO_AO_INT0_X2, GPIO_AO_INT1_X1, GPIO_AO_INT1_X2,
            GPIO_AO_INT2_X1, GPIO_AO_INT2_X2, GPIO_AO_INT3_X1, GPIO_AO_INT3_X2]


      additionalProperties: false

      allOf:
        - if:
            properties:
              function:
                enum:
                  - GPIO
          then:
            properties:
              groups:
                enum:
                  - all groups
        - if:
            properties:
              function:
                enum:
                  - EMMC
          then:
            properties:
              groups:
                enum:
                  - EMMC
        - if:
            properties:
              function:
                enum:
                  - SD_CARD
          then:
            properties:
              groups:
                enum:
                  - SD_CARD
        - if:
            properties:
              function:
                enum:
                  - SPI_FLASH
          then:
            properties:
              groups:
                enum:
                  - SPI_FLASH

        - if:
            properties:
              function:
                enum:
                  - SPI_NAND
          then:
            properties:
              groups:
                enum:
                  - SPI_NAND_X1
        - if:
            properties:
              function:
                enum:
                  - PARA_NAND
          then:
            properties:
              groups:
                enum:
                  - PARA_NAND
        - if:
            properties:
              function:
                enum:
                  - UART0
          then:
            properties:
              groups:
                enum:
                  - UART0_X1
        - if:
            properties:
              function:
                enum:
                  - UART1
          then:
            properties:
              groups:
                enum:
                  - UART1_X1
        - if:
            properties:
              function:
                enum:
                  - UART1_FC
          then:
            properties:
              groups:
                enum:
                  - UART1_FC_X1
        - if:
            properties:
              function:
                enum:
                  - UART2
          then:
            properties:
              groups:
                enum:
                  - UART2_X1
        - if:
            properties:
              function:
                enum:
                  - UART2_FC
          then:
            properties:
              groups:
                enum:
                  - UART2_FC_X1
        - if:
            properties:
              function:
                enum:
                  - UART3
          then:
            properties:
              groups:
                enum:
                  - UART3_X1
        - if:
            properties:
              function:
                enum:
                  - UADBG
          then:
            properties:
              groups:
                enum:
                  - UADBG
        - if:
            properties:
              function:
                enum:
                  - UART6
          then:
            properties:
              groups:
                enum:
                  - UART6_X1
        - if:
            properties:
              function:
                enum:
                  - UART7
          then:
            properties:
              groups:
                enum:
                  - UART7
        - if:
            properties:
              function:
                enum:
                  - SPI_MASTER0
          then:
            properties:
              groups:
                enum:
                  - SPI_MASTER0_X1
        - if:
            properties:
              function:
                enum:
                  - SPI_MASTER2
          then:
            properties:
              groups:
                enum:
                  - SPI_MASTER2
        - if:
            properties:
              function:
                enum:
                  - SPI_MASTER3
          then:
            properties:
              groups:
                enum:
                  - SPI_MASTER3_X2
        - if:
            properties:
              function:
                enum:
                  - SPI_MASTER4
          then:
            properties:
              groups:
                enum:
                  - SPI_MASTER4
        - if:
            properties:
              function:
                enum:
                  - SPI_SLAVE0
          then:
            properties:
              groups:
                enum:
                  - SPI_SLAVE0_X1
        - if:
            properties:
              function:
                enum:
                  - I2C_COMBO0
          then:
            properties:
              groups:
                enum:
                  - I2C_COMBO0_X1
        - if:
            properties:
              function:
                enum:
                  - I2C_COMBO1
          then:
            properties:
              groups:
                enum:
                  - I2C_COMBO1
        - if:
            properties:
              function:
                enum:
                  - I2C_COMBO2
          then:
            properties:
              groups:
                enum:
                  - I2C_COMBO2_X1
        - if:
            properties:
              function:
                enum:
                  - I2C_COMBO3
          then:
            properties:
              groups:
                enum:
                  - I2C_COMBO3
        - if:
            properties:
              function:
                enum:
                  - I2C_COMBO4
          then:
            properties:
              groups:
                enum:
                  - I2C_COMBO4
        - if:
            properties:
              function:
                enum:
                  - I2C_COMBO5
          then:
            properties:
              groups:
                enum:
                  - I2C_COMBO5
        - if:
            properties:
              function:
                enum:
                  - I2C_COMBO6
          then:
            properties:
              groups:
                enum:
                  - I2C_COMBO6_X1

        - if:
            properties:
              function:
                enum:
                  - I2C_COMBO7
          then:
            properties:
              groups:
                enum:
                  - I2C_COMBO7_X1
        - if:
            properties:
              function:
                enum:
                  - I2C_COMBO8
          then:
            properties:
              groups:
                enum:
                  - I2C_COMBO8_X1
        - if:
            properties:
              function:
                enum:
                  - I2C_COMBO9
          then:
            properties:
              groups:
                enum:
                  - I2C_COMBO9_X1
        - if:
            properties:
              function:
                enum:
                  - GMAC
          then:
            properties:
              groups:
                enum:
                  - GMAC_RGMII
        - if:
            properties:
              function:
                enum:
                  - USB_OTG
          then:
            properties:
              groups:
                enum:
                  - USB_OTG
        - if:
            properties:
              function:
                enum:
                  - SDIO
          then:
            properties:
              groups:
                enum:
                  - SDIO
        - if:
            properties:
              function:
                enum:
                  - PWM0
          then:
            properties:
              groups:
                enum:
                  - PWM0_X1
        - if:
            properties:
              function:
                enum:
                  - PWM1
          then:
            properties:
              groups:
                enum:
                  - PWM1_X1
        - if:
            properties:
              function:
                enum:
                  - PWM2
          then:
            properties:
              groups:
                enum:
                  - PWM2_X1
        - if:
            properties:
              function:
                enum:
                  - PWM3
          then:
            properties:
              groups:
                enum:
                  - PWM3_X1
        - if:
            properties:
              function:
                enum:
                  - AUD_TDMTX_XCK
          then:
            properties:
              groups:
                enum:
                  - AUD_TDMTX_XCK
        - if:
            properties:
              function:
                enum:
                  - AUD_DAC_XCK
          then:
            properties:
              groups:
                enum:
                  - AUD_DAC_XCK
        - if:
            properties:
              function:
                enum:
                  - AUD_DAC_XCK1
          then:
            properties:
              groups:
                enum:
                  - AUD_DAC_XCK1
        - if:
            properties:
              function:
                enum:
                  - AUD_AU2_DATA0
          then:
            properties:
              groups:
                enum:
                  - AUD_AU2_DATA0
        - if:
            properties:
              function:
                enum:
                  - AUD_AU1_DATA0
          then:
            properties:
              groups:
                enum:
                  - AUD_AU1_DATA0
        - if:
            properties:
              function:
                enum:
                  - AUD_AU2_CK
          then:
            properties:
              groups:
                enum:
                  - AUD_AU2_CK
        - if:
            properties:
              function:
                enum:
                  - AUD_AU1_CK
          then:
            properties:
              groups:
                enum:
                  - AUD_AU1_CK
        - if:
            properties:
              function:
                enum:
                  - AUD_AU_ADC_DATA0
          then:
            properties:
              groups:
                enum:
                  - AUD_AU_ADC_DATA0_X1
        - if:
            properties:
              function:
                enum:
                  - AUD_ADC2_DATA0
          then:
            properties:
              groups:
                enum:
                  - AUD_ADC2_DATA0
        - if:
            properties:
              function:
                enum:
                  - AUD_ADC1_DATA0
          then:
            properties:
              groups:
                enum:
                  - AUD_ADC1_DATA0
        - if:
            properties:
              function:
                enum:
                  - AUD_TDM
          then:
            properties:
              groups:
                enum:
                  - AUD_TDM
        - if:
            properties:
              function:
                enum:
                  - SPDIF_IN
          then:
            properties:
              groups:
                enum:
                  - SPDIF_IN_X1
        - if:
            properties:
              function:
                enum:
                  - SPDIF_OUT
          then:
            properties:
              groups:
                enum:
                  - SPDIF_OUT_X1
        - if:
            properties:
              function:
                enum:
                  - INT0
          then:
            properties:
              groups:
                enum:
                  - INT0_X1
        - if:
            properties:
              function:
                enum:
                  - INT1
          then:
            properties:
              groups:
                enum:
                  - INT1_X1
        - if:
            properties:
              function:
                enum:
                  - INT2
          then:
            properties:
              groups:
                enum:
                  - INT2_X1
        - if:
            properties:
              function:
                enum:
                  - INT3
          then:
            properties:
              groups:
                enum:
                  - INT3_X1
        - if:
            properties:
              function:
                enum:
                  - INT4
          then:
            properties:
              groups:
                enum:
                  - INT4_X1
        - if:
            properties:
              function:
                enum:
                  - INT5
          then:
            properties:
              groups:
                enum:
                  - INT5_X1
        - if:
            properties:
              function:
                enum:
                  - INT6
          then:
            properties:
              groups:
                enum:
                  - INT6_X1
        - if:
            properties:
              function:
                enum:
                  - INT7
          then:
            properties:
              groups:
                enum:
                  - INT7_X1
        - if:
            properties:
              function:
                enum:
                  - GPIO_AO_INT0
          then:
            properties:
              groups:
                enum:
                  - GPIO_AO_INT0_X1
        - if:
            properties:
              function:
                enum:
                  - GPIO_AO_INT1
          then:
            properties:
              groups:
                enum:
                  - GPIO_AO_INT1_X1
        - if:
            properties:
              function:
                enum:
                  - GPIO_AO_INT2
          then:
            properties:
              groups:
                enum:
                  - GPIO_AO_INT2_X1
        - if:
            properties:
              function:
                enum:
                  - GPIO_AO_INT3
          then:
            properties:
              groups:
                enum:
                  - GPIO_AO_INT3_X1

required:
  - compatible
  - reg
  - reg-names
  - "#gpio-cells"
  - gpio-controller

additionalProperties: false

examples:
  - |
    #include <dt-bindings/clock/sp-sp7350.h>
    #include <dt-bindings/reset/sp-sp7350.h>
    #include <dt-bindings/pinctrl/sppctl-sp7350.h>

    pctl: pinctrl@f8800080 {
        compatible = "sunplus,sp7350-pctl";
        reg = <0x0 0xf8800080 0x0 0x2c>,
              <0x0 0xf8803280 0x0 0x60>,
              <0x0 0xf88032e4 0x0 0x1c>,
              <0x0 0xf8803300 0x0 0x80>,
              <0x0 0xf8803380 0x0 0x180>,
              <0x0 0xf8802f80 0x0 0x1c>;
        reg-names = "moon1", "pad_ctl_1", "first", "pad_ctl_2", "gpioxt", "gpio_ao_int";
        gpio-controller;
        #gpio-cells = <2>;

        emmc_pins: pinmux_emmc-pins {
            function = "EMMC";
            groups = "EMMC";
        };

        sdcard_pins: pinmux_sdcard-pins {
            function = "SD_CARD";
            groups = "SD_CARD";
        };

        typec_pins: pinmux_typec-pins {
            pins = "GPIO98";
            function = "GPIO";
        };

        dwc3id_pins: pinmux_usb3id-pins {
            pins = "GPIO99";
            function = "GPIO";
        };

        spi_nor_pins: pinmux_spi_nor-pins {
            function = "SPI_FLASH";
            groups = "SPI_FLASH";
        };

        spi_nand_pins: pinmux_spi_nand-pins {
            function = "SPI_NAND";
            groups = "SPI_NAND_X1";
        };

        para_nand_pins: pinmux_para_nand-pins {
            function = "PARA_NAND";
            groups = "PARA_NAND";
        };

        uart0_pins: pinmux_uart0-pins {
            function = "UART0";
            groups = "UART0_X1";
        };
    };
...
```
