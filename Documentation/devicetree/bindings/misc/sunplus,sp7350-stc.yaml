## Documentation/devicetree/bindings/sound/sunplus,audio.yaml
```yaml
# SPDX-License-Identifier: GPL-2.0
%YAML 1.2
---
$id: http://devicetree.org/schemas/sound/sunplus,audio.yaml#
$schema: http://devicetree.org/meta-schemas/core.yaml#

title: Sunplus Aduio controller

maintainers:
  - ChingChou Huang <chingchou.huang@sunplus.com>

description: |
  Sunplus Audio controller.
  The device node of Sunplus Audio controller has following properties.

properties:
  compatible:
    items:
      - const: sunplus,audio

  reg:
    items:
      - description: Base address and length of the Audio registers.

  reg-names:
    maxItems: 1

  clocks:
    description: |
      Clock controller selector for Audio controller.
    maxItems: 1

  clock-names:
    maxItems: 1

  resets:
    description: |
      Reset controller selector for Audio controller.
    maxItems: 1

additionalProperties: false

required:
  - compatible
  - reg
  - reg-names
  - clocks
  - clock-names
  - resets

examples:
  - |
    #include <dt-bindings/clock/sp-sp7350.h>
    #include <dt-bindings/reset/sp-sp7350.h>
    audio: audio@f8800480 {
        compatible = "sunplus,audio";
        reg = <0xf8800480 0x700>;
        reg-names = "audio";
        clocks = <&clkc AUD>;
        clock-names = "aud";
        resets = <&rstc RST_AUD>;
    };
...
```

## Documentation/devicetree/bindings/thermal/sunplus,sp7350-thermal.yaml
```yaml
# SPDX-License-Identifier: (GPL-2.0-only OR BSD-2-Clause)
# Copyright (C) Sunplus Ltd. Co. 2021
%YAML 1.2
---
$id: http://devicetree.org/schemas/thermal/sunplus,sp7350-thermal.yaml#
$schema: http://devicetree.org/meta-schemas/core.yaml#

title: Temperature Sensor in Sunplus SoCs

maintainers:
  - Li-hao Kuo <lhjeff911@gmail.com>

properties:
  compatible:
    enum:
      - sunplus,sp7350-thermal

  reg:
    maxItems: 1

  clocks:
    maxItems: 1

  resets:
    maxItems: 1

required:
  - compatible
  - reg
  - clocks
  - resets

additionalProperties: false

examples:
  - |
    adc@0 {
      compatible = "sunplus,sp7350-thermal";
      reg = <0xf88002b4 0x80>;
      clocks = <&clkc 0x4e>;
      resets = <&rstc 0x3e>;
    };
...
```

## Documentation/devicetree/bindings/usb/sunplus,sp7350-ehci.yaml
```yaml
# SPDX-License-Identifier: (GPL-2.0 OR BSD-2-Clause)
%YAML 1.2
---
$id: http://devicetree.org/schemas/usb/sunplus,sp7350-ehci.yaml#
$schema: http://devicetree.org/meta-schemas/core.yaml#

title: Sunplus USB EHCI Controller

allOf:
  - $ref: usb-hcd.yaml

maintainers:
  - Vincent Shih <vincent.shih@sunplus.com>

properties:
  compatible:
    const: sunplus,sp7350-usb-ehci

  reg:
    maxItems: 1

  clocks:
    maxItems: 1

  resets:
    maxItems: 1

  interrupts:
    maxItems: 1

  phys:
    maxItems: 1

  phy-names:
    const: uphy

required:
  - compatible
  - reg
  - clocks
  - resets
  - interrupts
  - phys
  - phy-names

additionalProperties: false

examples:
  - |
    #include <dt-bindings/clock/sp-sp7350.h>
    #include <dt-bindings/reset/sp-sp7350.h>
    #include <dt-bindings/interrupt-controller/irq.h>
    #include <dt-bindings/interrupt-controller/arm-gic.h>

    soc {
      #address-cells = <2>;
      #size-cells = <2>;

      ehci0: usb@f8102100 {
        compatible = "sunplus,sp7350-usb-ehci";
        reg = <0x00 0xf8102100 0x00 0x68>;
        clocks = <&clkc USBC0>;
        resets = <&rstc RST_USBC0>;
        interrupt-parent = <&gic>;
        interrupts = <GIC_SPI 183 IRQ_TYPE_LEVEL_HIGH>;
        phys = <&sp_uphy0>;
        phy-names = "uphy";
      };
    };

...
```

## Documentation/devicetree/bindings/usb/sunplus,sp7350-ohci.yaml
```yaml
# SPDX-License-Identifier: (GPL-2.0 OR BSD-2-Clause)
%YAML 1.2
---
$id: http://devicetree.org/schemas/usb/sunplus,sp7350-ohci.yaml#
$schema: http://devicetree.org/meta-schemas/core.yaml#

title: Sunplus USB OHCI Controller

allOf:
  - $ref: usb-hcd.yaml

maintainers:
  - Vincent Shih <vincent.shih@sunplus.com>

properties:
  compatible:
    const: sunplus,sp7350-usb-ohci

  reg:
    maxItems: 2

  clocks:
    maxItems: 1

  resets:
    maxItems: 1

  interrupts:
    maxItems: 1

  phys:
    maxItems: 1

  phy-names:
    const: uphy

required:
  - compatible
  - reg
  - clocks
  - resets
  - interrupts
  - phys
  - phy-names

additionalProperties: false

examples:
  - |
    #include <dt-bindings/clock/sp-sp7350.h>
    #include <dt-bindings/reset/sp-sp7350.h>
    #include <dt-bindings/interrupt-controller/irq.h>
    #include <dt-bindings/interrupt-controller/arm-gic.h>

    soc {
      #address-cells = <2>;
      #size-cells = <2>;

      ohci0: usb@f8102080 {
        compatible = "sunplus,sp7350-usb-ohci";
        reg = <0x00 0xf8102080 0x00 0x68>, <0x00 0xf8800000 0x00 0x80>;
        clocks = <&clkc USBC0>;
        resets = <&rstc RST_USBC0>;
        interrupt-parent = <&gic>;
        interrupts = <GIC_SPI 184 IRQ_TYPE_LEVEL_HIGH>;
        phys = <&sp_uphy0>;
        phy-names = "uphy";
      };
    };

...
```

## Documentation/devicetree/bindings/usb/sunplus,sp7350-otg.yaml
```yaml
# SPDX-License-Identifier: (GPL-2.0 OR BSD-2-Clause)
%YAML 1.2
---
$id: http://devicetree.org/schemas/usb/sunplus,sp7350-otg.yaml#
$schema: http://devicetree.org/meta-schemas/core.yaml#

title: Sunplus USB2.0 OTG Controller

maintainers:
  - Vincent Shih <vincent.shih@sunplus.com>

properties:
  compatible:
    const: sunplus,sp7350-usb-otg

  reg:
    maxItems: 1

  clocks:
    maxItems: 1

  resets:
    maxItems: 1

  interrupts:
    maxItems: 1

  phys:
    maxItems: 1

  phy-names:
    const: uphy

required:
  - compatible
  - reg
  - clocks
  - resets
  - interrupts
  - phys
  - phy-names

additionalProperties: false

examples:
  - |
    #include <dt-bindings/clock/sp-sp7350.h>
    #include <dt-bindings/reset/sp-sp7350.h>
    #include <dt-bindings/interrupt-controller/irq.h>
    #include <dt-bindings/interrupt-controller/arm-gic.h>

    soc {
      #address-cells = <2>;
      #size-cells = <2>;
      
      otg: usb@f8102400 {
        compatible = "sunplus,sp7350-usb-otg";
        reg = <0x0 0xf8102400 0x0 0x80>;
        clocks = <&clkc USBC0>;
        resets = <&rstc RST_USBC0>;
        interrupt-parent = <&gic>;
        interrupts = <GIC_SPI 181 IRQ_TYPE_LEVEL_HIGH>;
        phys = <&sp_uphy0>;
        phy-names = "uphy";
      };
    };
...
```

## Documentation/devicetree/bindings/usb/sunplus,usb3phy.yaml
```yaml
# SPDX-License-Identifier: (GPL-2.0-only OR BSD-2-Clause)
%YAML 1.2
---
$id: http://devicetree.org/schemas/usb/sunplus,usb3phy.yaml#
$schema: http://devicetree.org/meta-schemas/core.yaml#

title: Sunplus USB3 Super-Speed (SS) PHY

maintainers:
  - ChingChou Huang <chingchou.huang@sunplus.com>
  
description: |
  This describes the devicetree bindings for PHY interfaces built into
  USB3 controller implemented on Sunplus SP7350 SoCs.
 
properties:
  compatible:
    const: sunplus,usb3-phy
   
  reg:
    maxItems: 3

  interrupts:
    description: |
      Contains number and type of interrupt. Number should be 191.
      Type should be high-level trigger
    maxItems: 1
    
  clocks:
    description: |
      Clock controller selector for usb3 phy.
    maxItems: 2

  clock-names:
    maxItems: 2

  resets:
    description: |
      Reset controller selector for usb3 phy.
    maxItems: 1

  reset-names:
    maxItems: 1

  "#phy-cells":
    const: 0
    
required:
  - compatible
  - reg
  - interrupts
  - clocks
  - clock-names
  - resets
  - reset-names
  - "#phy-cells"
  
additionalProperties: false

examples:
  - |
    #include <dt-bindings/interrupt-controller/irq.h>
    #include <dt-bindings/interrupt-controller/arm-gic.h>
    #include <dt-bindings/clock/sp-sp7350.h>
    #include <dt-bindings/reset/sp-sp7350.h>
    u3phy0: uphy@f80bd000 {
        compatible = "sunplus,usb3-phy";
        reg = <0xf80bd000 0x80>, <0xf80a1430 0x80>, <0xf80ad700 0x80>;
        interrupt-parent = <&gic>;
        interrupts = <GIC_SPI 191 IRQ_TYPE_LEVEL_HIGH>;
        clocks = <&clkc U3PHY0>, <&clkc USB30C0>;
        clock-names = "clkc_u3phy", "clkc_u3";
        resets = <&rstc RST_U3PHY0>;
        reset-names = "rstc_u3phy";
        #phy-cells = <0>;
    };
...
```

## Documentation/devicetree/bindings/watchdog/sunplus,sp7350-wdt.yaml
```yaml
# SPDX-License-Identifier: (GPL-2.0-only OR BSD-2-Clause)
# Copyright (C) Sunplus Co., Ltd. 2024
%YAML 1.2
---
$id: http://devicetree.org/schemas/watchdog/sunplus,sp7350-wdt.yaml#
$schema: http://devicetree.org/meta-schemas/core.yaml#

title: Sunplus SoCs Watchdog

maintainers:
  - XianTao Hu <xt.hu@sunmedia.com.cn>

allOf:
  - $ref: watchdog.yaml#

properties:
  compatible:
    const: sunplus,sp7350-wdt

  reg:
    items:
      - description: watchdog control and counter registers regions
      - description: watchdog mode select and pretimeout registers regions
      - description: watchdog reset enable registers regions
      - description: STC pre-scaling registers regions

  interrupts:
    maxItems: 1

  clocks:
    maxItems: 1

  resets:
    maxItems: 1

required:
  - compatible
  - reg
  - interrupts
  - clocks
  - resets

additionalProperties: false

examples:
  - |
    #include <dt-bindings/interrupt-controller/arm-gic.h>
    #include <dt-bindings/clock/sp-sp7350.h>
    #include <dt-bindings/reset/sp-sp7350.h>
    soc {
      #address-cells = <2>;
      #size-cells = <2>;
      watchdog: watchdog@f800061c {
          compatible = "sunplus,sp7350-wdt";
          reg = <0x00 0xf800061c 0x00 0x08>, <0x00 0xf800066c 0x00 0x08>,
                <0x00 0xf8800258 0x00 0x04>, <0x00 0xf800060c 0x00 0x04>;
          interrupt-parent = <&gic>;
          interrupts = <GIC_SPI 113 IRQ_TYPE_LEVEL_HIGH>;
          clocks = <&clkc STC_AV3>;
          resets = <&rstc RST_STC_AV3>;
      };
    };
...
```
