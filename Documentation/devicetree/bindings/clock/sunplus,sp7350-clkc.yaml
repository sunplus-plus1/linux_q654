## Documentation/devicetree/bindings/hwlock/sp,sp-hwspinlock.yaml
```yaml
# SPDX-License-Identifier: (GPL-2.0-only OR BSD-2-Clause)
# Copyright (C) Sunplus Co., Ltd. 2021
%YAML 1.2
---
$id: http://devicetree.org/schemas/hwlock/sp,sp-hwspinlock.yaml#
$schema: http://devicetree.org/meta-schemas/core.yaml#

title: Sunplus Hardware Spinlock

maintainers:
  - hq.tang <hq.tang@sunmedia.com.cn>

properties:
  "#hwlock-cells":
    const: 1

  compatible:
    const: sp,sunplus-hwspinlock

  reg:
    maxItems: 1

  clocks:
    maxItems: 1

  clock-names:
    items:
      - const: hsem

required:
  - "#hwlock-cells"
  - compatible
  - reg
  - clocks
  - clock-names

additionalProperties: false

examples:
  - |
    #include <dt-bindings/clock/sp-sp7350.h>
    soc {
      #address-cells = <2>;
      #size-cells = <2>;
      hwspinlock@4c000000 {
        compatible = "sunplus,sp-hwspinlock";
        #hwlock-cells = <1>;
        reg = <0 0xf800f880 0 0x80>;
        clocks = <&clkc SEMAPHORE>;
        clock-names = "hsem";
      };
    };

...
```

## Documentation/devicetree/bindings/iio/adc/sunplus,sp7350-adc.yaml
```yaml
# SPDX-License-Identifier: (GPL-2.0-only OR BSD-2-Clause)
# Copyright (C) Sunplus Ltd. Co. 2021
%YAML 1.2
---
$id: http://devicetree.org/schemas/iio/adc/sunplus,sp7350-adc.yaml#
$schema: http://devicetree.org/meta-schemas/core.yaml#

title: Sunplus ADCs

maintainers:
  - Li-hao Kuo <lhjeff911@gmail.com>

properties:
  compatible:
    enum:
      - sunplus,sp7350-adc

  reg:
    maxItems: 1

  clocks:
    maxItems: 1

  resets:
    maxItems: 1

required:
  - compatible
  - reg
  - clocks
  - resets

additionalProperties: false

examples:
  - |
    adc@0 {
      compatible = "sunplus,sp7350-adc";
      reg = <0xf8802f00 0x80>;
      clocks = <&clkc 0x4e>;
      resets = <&rstc 0x3e>;
    };
...
```

## Documentation/devicetree/bindings/mailbox/sunplus-mailbox.yaml
```yaml
# SPDX-License-Identifier: (GPL-2.0 OR BSD-2-Clause)
%YAML 1.2
---
$id: http://devicetree.org/schemas/mailbox/sunplus-mailbox.yaml#
$schema: http://devicetree.org/meta-schemas/core.yaml#

title: Sunplus Mailbox Driver for Sunplus SoCs

description:
  Each Sunplus Mailbox IP currently consists of 1 instances of 2 channels(TX/RX).
  Messages are passed between Application and Remote processors using 20 32bits
  regs.

maintainers:
  - Qin Jian <qinjian@sunmedia.com.cn>

properties:
  compatible:
    const: sunplus,sunplus-mbox

  reg:
    maxItems: 2

  res-names:
    $ref: /schemas/types.yaml#/definitions/string
    description: name of the channels

  interrupts:
    description: the irq line for the RX mailbox
    maxItems: 1

  clocks:
    maxItems: 1

  "#mbox-cells":
    const: 1

required:
  - compatible
  - reg
  - interrupts
  - clocks
  - "#mbox-cells"

additionalProperties: false

examples:
  - |
    #include <dt-bindings/interrupt-controller/arm-gic.h>
    #include <dt-bindings/clock/sp-sp7350.h>
    mbox: mbox@f8008100 {
      compatible = "sunplus,sunplus-mbox";
      reg = <0xf8008100 0x60>, <0xf8008180 0x60>;
      interrupts = <GIC_SPI 126 IRQ_TYPE_LEVEL_HIGH>;
      clocks = <&clkc MAILBOX>;
      #mbox-cells = <1>;
    };

...
```

## Documentation/devicetree/bindings/media/sunplus,sp7350-display.yaml
```yaml
# SPDX-License-Identifier: (GPL-2.0 OR BSD-2-Clause)
%YAML 1.2
---
$id: http://devicetree.org/schemas/media/sunplus,sp7350-display.yaml#
$schema: http://devicetree.org/meta-schemas/core.yaml#

title: Sunplus SoC SP7350 Legacy Display Driver

maintainers:
  - Hammer Hsieh <hammer.hsieh@sunplus.com>

description: |
  - Sunplus SoC SP7350 Legacy Display Driver

properties:
  compatible:
    const: sunplus,sp7350-display

  reg:
    minItems: 1
    maxItems: 4

  interrupts:
    minItems: 1
    maxItems: 4

  clocks:
    minItems: 2
    maxItems: 20

  clock-names:
    minItems: 2
    maxItems: 20

  resets:
    minItems: 2
    maxItems: 20

  reset-names:
    minItems: 2
    maxItems: 20

required:
  - compatible
  - reg
  - interrupts
  - clocks
  - clock-names
  - resets
  - reset-names

additionalProperties: false

examples:
  - |
    #include <dt-bindings/interrupt-controller/irq.h>
    #include <dt-bindings/interrupt-controller/arm-gic.h>
    #include <dt-bindings/clock/sp-sp7350.h>
    #include <dt-bindings/reset/sp-sp7350.h>
    fb_disp_device: fb_disp_device {
      compatible = "sunplus,sp7350-fb";
    };

    display: display@f8005c80 {
      compatible = "sunplus,sp7350-display";
      reg = <0x00 0xf8005c80 0x00 0xa80>, <0x00 0xf8800180 0x00 0x80>;
      interrupt-parent = <&gic>;
      interrupts =
        <GIC_SPI 104 IRQ_TYPE_LEVEL_HIGH>, <GIC_SPI 105 IRQ_TYPE_LEVEL_HIGH>,
        <GIC_SPI 106 IRQ_TYPE_LEVEL_HIGH>, <GIC_SPI 107 IRQ_TYPE_LEVEL_HIGH>;
      clocks =
        <&clkc DISPSYS>, <&clkc DMIX>, <&clkc GPOST0>, <&clkc GPOST1>,
        <&clkc GPOST2>, <&clkc GPOST3>, <&clkc IMGREAD0>, <&clkc MIPITX>,
        <&clkc OSD0>, <&clkc OSD1>, <&clkc OSD2>, <&clkc OSD3>,
        <&clkc TCON>, <&clkc TGEN>, <&clkc VPOST0>, <&clkc VSCL0>;
      clock-names =
        "clkc_dispsys", "clkc_dmix", "clkc_gpost0", "clkc_gpost1",
        "clkc_gpost2", "clkc_gpost3", "clkc_imgread0", "clkc_mipitx",
        "clkc_osd0", "clkc_osd1", "clkc_osd2", "clkc_osd3",
        "clkc_tcon", "clkc_tgen", "clkc_vpost0", "clkc_vscl0";
      resets =
        <&rstc RST_DISPSYS>, <&rstc RST_DMIX>, <&rstc RST_GPOST0>, <&rstc RST_GPOST1>,
        <&rstc RST_GPOST2>, <&rstc RST_GPOST3>, <&rstc RST_IMGREAD0>, <&rstc RST_MIPITX>,
        <&rstc RST_OSD0>, <&rstc RST_OSD1>, <&rstc RST_OSD2>, <&rstc RST_OSD3>,
        <&rstc RST_TCON>, <&rstc RST_TGEN>, <&rstc RST_VPOST0>, <&rstc RST_VSCL0>;
      reset-names =
        "rstc_dispsys", "rstc_dmix", "rstc_gpost0", "rstc_gpost1",
        "rstc_gpost2", "rstc_gpost3", "rstc_imgread0", "rstc_mipitx",
        "rstc_osd0", "rstc_osd1", "rstc_osd2", "rstc_osd3",
        "rstc_tcon", "rstc_tgen", "rstc_vpost0", "rstc_vscl0";
    };
```

## Documentation/devicetree/bindings/media/sunplus,sp7350-gdc.yaml
```yaml
# SPDX-License-Identifier: GPL-2.0
%YAML 1.2
---
$id: http://devicetree.org/schemas/media/sunplus,sp7350-gdc.yaml#
$schema: http://devicetree.org/meta-schemas/core.yaml#

title: Sunplus Geometric Distortion Correction driver(GDC)

description:
  GDC is a highly configurable Geometrical Distortion Correction engine, 
  capable of performing up to four simultaneous geometric warp functions, 
  each displayed in a sub-window, at video resolutions up to 4K UHD. 
  GDC engine is suitable for video surveillance, fisheye correction, 
  automotive reversing cameras, and panoramic correction and dome cameras.

maintainers:
  - YuBo Leng <yb.leng@sunmedia.com.cn>

properties:
  compatible:
    const: sunplus,sp7350-gdc

  reg:
    description: | 
        Base address and length of the GDC registers.
    maxItems: 2
    
  memory-region:    
    maxItems: 1
    
  interrupts:
    description: | 
        Indicate that GDC finished processing the frame and in IDLE state.
    maxItems: 1

  clocks:
    maxItems: 3

  clock-names:
    items:
      - const: sys
      - const: axi
      - const: apb

  resets:
    maxItems: 3

  reset-names:
    items:
      - const: sys
      - const: axi
      - const: apb
      
  sunplus,max-config-size:
    description: | 
        The size(in byte) of internal buffer which is for binary configuration data.
        The size must be aligned to 4-byte.   
    $ref: /schemas/types.yaml#/definitions/uint32
    
  sunplus,devnode-number:
    description: | 
        The device node number which is used while registering v4l2 video device.
        If this property is omitted, driver will use the default value(-1).
    $ref: /schemas/types.yaml#/definitions/uint32
    
required:
  - compatible
  - reg
  - memory-region
  - interrupts
  - clocks
  - clock-names
  - resets
  - reset-names
  - sunplus,max-config-size

additionalProperties: false

examples:
  - |
    #include <dt-bindings/interrupt-controller/irq.h>
    #include <dt-bindings/interrupt-controller/arm-gic.h>
    #include <dt-bindings/clock/sp-sp7350.h>
    #include <dt-bindings/reset/sp-sp7350.h>
    gdc: gdc@f8c09000 {
        compatible = "sunplus,sp7350-gdc";
        reg = <0x0 0xf8c09000 0x0 0xff>;
        memory-region = <&gdc_reserve>;
        interrupt-parent = <&gic>;
        interrupts = <GIC_SPI 108 IRQ_TYPE_EDGE_RISING>;
        clocks = <&clkc VCL>, <&clkc VCL5>, <&clkc VCL3>;
        clock-names = "sys", "axi", "apb";
        resets = <&rstc RST_VCL>, <&rstc RST_VCL5>, <&rstc RST_VCL3>;
        reset-names = "sys", "axi", "apb";
        sunplus,max-config-size = <0x100000>;
        sunplus,devnode-number = <96>;
    };
```

## Documentation/devicetree/bindings/media/sunplus,sp7350-mipicsi-rx.txt
```
Sunplus SP7350 MIPI/CSI RX controller
-------------------------------------

The device node of Sunplus SP7350 MIPI/CSI RX controller has following
properties.

Required properties:
 - compatible: should be "sunplus,sp7350-mipicsi-rx".
 - reg: addresses and length of the register sets for MIPI CSI
        controller.
 - reg-names: one name for each entry in the reg property.
 - clocks: clock selector for MIPI CSI controller.
 - resets: reset controller selector for MIPI CSI controller.
 - pinctrl-names: Names corresponding to the numbered pinctrl states.
 - pinctrl-0: phandle for the 'default' state of pin configuration.

Example:

mipicsi0: mipicsirx@0xf8005280 {
	compatible = "sunplus,sp7350-mipicsi-rx";
	reg = <0x0 0xf8005280 0x0 0x80>;
	reg-names = "mipicsi";
	clocks = <&clkc MIPICSI0>;
	clock-names = "clk_mipicsi";
	resets = <&rstc RST_MIPICSI0>;
	reset-names = "rstc_mipicsi";
	sunplus,id = <0>;
};
```

## Documentation/devicetree/bindings/media/sunplus,sp7350-mipicsi-rx.yaml
```yaml
# SPDX-License-Identifier: (GPL-2.0-only OR BSD-2-Clause)
# Copyright (C) 2020 sunplus Electronics Corp.
%YAML 1.2
---
$id: http://devicetree.org/schemas/media/sunplus,sp7350-mipicsi-rx.yaml#
$schema: http://devicetree.org/meta-schemas/core.yaml#

title: sunplus MIPI CSI-2 receiver

maintainers:
  - JiaWei Li <jw.li@sunmedia.com.cn>
  - Cheng Chung Ho <cc.ho@sunplus.com>

description:
  The CSI-2 receiver device provides MIPI CSI-2 capabilities for the
  sunplus devices. It is used in conjunction with the VIN module,
  which provides the video capture capabilities.

properties:
  compatible:
    enum:
      - sunplus,sp7350-mipicsi-rx

  reg:
    maxItems: 2

  reg-names:
    items:
      - const: mipicsi

  clocks:
    maxItems: 1

  clock-names:
    items:
      - const: clk_mipicsi

  resets:
    maxItems: 1

  resets-name:
    items:
      - const: rstc_mipicsi

  sunplus,id:
    description: mipicsi rx number
    $ref: /schemas/types.yaml#/definitions/uint32
    minimum: 0
    maximum: 5

  max_channels:
    $ref: /schemas/types.yaml#/definitions/uint32

  num_channels:
    $ref: /schemas/types.yaml#/definitions/uint32
  ports:
    $ref: /schemas/graph.yaml#/properties/ports

    properties:
      port@0:
        $ref: /schemas/graph.yaml#/$defs/port-base
        unevaluatedProperties: false
        description:
          Input port node, single endpoint describing the CSI-2 transmitter.

        properties:
          endpoint:
            $ref: video-interfaces.yaml#
            unevaluatedProperties: false

            properties:
              clock-lanes:
                maxItems: 1

              data-lanes:
                minItems: 1
                maxItems: 4
                items:
                  maximum: 4

              bus-type:
                maxItems: 1

            required:
              - clock-lanes
              - data-lanes

      port@1:
        $ref: /schemas/graph.yaml#/properties/port
        description:
          Output port node, multiple endpoints describing all the VIN
          modules connected the CSI-2 receiver.

    required:
      - port@0
      - port@1

required:
  - compatible
  - reg
  - clocks
  - resets
  - ports

additionalProperties: false

examples:
  - |
    #include <dt-bindings/interrupt-controller/irq.h>
    #include <dt-bindings/interrupt-controller/arm-gic.h>
    #include <dt-bindings/gpio/gpio.h>
    #include <dt-bindings/clock/sp-sp7350.h>
    #include <dt-bindings/reset/sp-sp7350.h>

    mipicsirx0: csirx@f8005280 {
            compatible = "sunplus,sp7350-mipicsi-rx";
            reg = <0x0 0xf8005280 0x0 0x80>;
            reg-names = "mipicsi";
            clocks = <&clkc MIPICSI0>;
            clock-names = "clk_mipicsi";
            resets = <&rstc RST_MIPICSI0>;
            sunplus,id = <0>;
            max_channels = <4>;
            num_channels = <1>;

            ports {
                    #address-cells = <1>;
                    #size-cells = <0>;
                    port@0 {
                            reg = <0>;
                            csi2_0: endpoint {
                              remote-endpoint = <&imx219_0>;
                              bus-type = <4>;
                              clock-lanes = <0>;
                              data-lanes = <1 2>;
                            };
                    };

                    port@1 {
                            #address-cells = <1>;
                            #size-cells = <0>;

                            reg = <1>;
                            csi0vin0: endpoint@0 {
                              reg = <0>;
                              remote-endpoint = <&vin0csi0>;
                            };

                            csi0vin1: endpoint@1 {
                              reg = <1>;
                              remote-endpoint = <&vin1csi0>;
                            };
                    };
            };
    };
```

## Documentation/devicetree/bindings/media/sunplus,sp7350-npu.yaml
```yaml
# SPDX-License-Identifier: (GPL-2.0 OR BSD-2-Clause)
%YAML 1.2
---
$id: http://devicetree.org/schemas/media/sunplus,sp7350-npu.yaml#
$schema: http://devicetree.org/meta-schemas/core.yaml#

title: ML Inference Processor NPU

maintainers:
  - Luo Yang <yang.luo@sunmedia.com.cn>

description: |
  - ML Inference Processor NPU hardware in Sunplus SoCs

properties:
  compatible:
    const: galcore

  reg:
    maxItems: 2

  reg-names:
    items:
      - const: galcore
      - const: gal_ios

  memory-region:
    maxItems: 1
    description: Reference to the reserved-memory for the npu core

  dev_name:
    const: galcore

  interrupts:
    maxItems: 1

  clocks:
    maxItems: 1

  clock-names:
    const: clk_npu

  clock-frequency:
    description: Frequency of clock in Hz
    default: 900000000

  resets:
    maxItems: 1

  reset-names:
    const: rstc_npu

required:
  - compatible
  - reg
  - reg-names
  - dev_name
  - memory-region
  - interrupts
  - clocks
  - clock-names
  - clock-frequency
  - resets
  - reset-names

additionalProperties: false

examples:
  - |
    #include <dt-bindings/interrupt-controller/irq.h>
    #include <dt-bindings/interrupt-controller/arm-gic.h>
    #include <dt-bindings/clock/sp-sp7350.h>
    #include <dt-bindings/reset/sp-sp7350.h>
    galcore: galcore@f8140000 {
      compatible = "galcore";
      reg = <0xf8140000 0x20000>, <0xf880125c 0xff>;
      reg-names = "galcore","gal_ios";
      dev_name = "galcore";
      memory-region = <&npu_reserve>;
      interrupt-parent = <&gic>;
      interrupts = <GIC_SPI 165 IRQ_TYPE_LEVEL_HIGH>;
      clocks = <&clkc NPU>;
      clock-names = "clk_npu";
      clock-frequency = <900000000>;
      resets = <&rstc RST_NPU>;
      reset-names = "rstc_npu";
    };
```
