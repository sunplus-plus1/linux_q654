## Documentation/devicetree/bindings/clock/sunplus,sp7350-clkc.yaml
```yaml
# SPDX-License-Identifier: (GPL-2.0-only OR BSD-2-Clause)
# Copyright (C) Sunplus Co., Ltd. 2021
%YAML 1.2
---
$id: http://devicetree.org/schemas/clock/sunplus,sp7350-clkc.yaml#
$schema: http://devicetree.org/meta-schemas/core.yaml#

title: Sunplus SP7350 SoC Clock Controller

maintainers:
  - Qin Jian <qinjian@sunmedia.com.cn>

properties:
  compatible:
    const: sunplus,sp7350-clkc

  reg:
    maxItems: 2

  "#clock-cells":
    const: 1

required:
  - compatible
  - reg
  - "#clock-cells"

additionalProperties: false

examples:
  - |
    clkc: clock-controller@f8800104 {
      compatible = "sunplus,sp7350-clkc";
      reg = <0xf8800104 0x28>,
            <0xf8800f00 0x80>;
      #clock-cells = <1>;
    };

...
```

## Documentation/devicetree/bindings/cpufreq/sunplus,sp7350-cpufreq.yaml
```yaml
# SPDX-License-Identifier: GPL-2.0-only OR BSD-2-Clause
%YAML 1.2
---
$id: http://devicetree.org/schemas/cpufreq/sunplus,sp7350-cpufreq.yaml#
$schema: http://devicetree.org/meta-schemas/core.yaml#

title: Sunplus SP7350 SoC cpufreq device

maintainers:
  - Qin Jian <qinjian@sunmedia.com.cn>

description:
  CPUFREQ engine used by Sunplus SP7350 SoC to manage
  frequency & voltage for all CPU cores.

patternProperties:
  '^opp-table(-[a-z0-9]+)?$':
    properties:
      compatible:
        const: operating-points-v2
    $ref: /schemas/opp/opp-v2.yaml#

    unevaluatedProperties: false

additionalProperties: false

examples:
  - |
    #include <dt-bindings/clock/sp-sp7350.h>
    i2c {
      #address-cells = <1>;
      #size-cells = <0>;

      cpu_vdd_reg: regulator@62 {
        compatible = "richtek,rt5759";
        reg = <0x62>;
        regulator-name = "rt5759-buck";
        regulator-min-microvolt = <630000>;
        regulator-max-microvolt = <1100000>;
        regulator-allowed-modes = <0 1>;
        regulator-initial-mode = <1>;
        regulator-always-on;
      };
    };

    cpus {
      #address-cells = <1>;
      #size-cells = <0>;

      cpu0: cpu@0 {
        device_type = "cpu";
        compatible = "arm,cortex-a55";
        reg = <0x0000>;
        enable-method = "psci";
        clocks = <&clkc PLLC>, <&clkc PLLL3>;
        clock-names = "PLLC", "PLLL3";
        proc-supply = <&cpu_vdd_reg>;
        operating-points-v2 = <&cpu_opp_table>;
      };

      cpu1: cpu@1 {
        device_type = "cpu";
        compatible = "arm,cortex-a55";
        reg = <0x0100>;
        enable-method = "psci";
        clocks = <&clkc PLLC>, <&clkc PLLL3>;
        clock-names = "PLLC", "PLLL3";
        proc-supply = <&cpu_vdd_reg>;
        operating-points-v2 = <&cpu_opp_table>;
      };

      cpu2: cpu@2 {
        device_type = "cpu";
        compatible = "arm,cortex-a55";
        reg = <0x0200>;
        enable-method = "psci";
        clocks = <&clkc PLLC>, <&clkc PLLL3>;
        clock-names = "PLLC", "PLLL3";
        proc-supply = <&cpu_vdd_reg>;
        operating-points-v2 = <&cpu_opp_table>;
      };

      cpu3: cpu@3 {
        device_type = "cpu";
        compatible = "arm,cortex-a55";
        reg = <0x0300>;
        enable-method = "psci";
        clocks = <&clkc PLLC>, <&clkc PLLL3>;
        clock-names = "PLLC", "PLLL3";
        proc-supply = <&cpu_vdd_reg>;
        operating-points-v2 = <&cpu_opp_table>;
      };
    };

    cpu_opp_table: opp-table {
      compatible = "operating-points-v2";
      opp-shared;

      opp-5 {
        opp-hz = /bits/ 64 <500000000>;
        opp-microvolt = <670000>;
      };

      opp-10 {
        opp-hz = /bits/ 64 <1000000000>;
        opp-microvolt = <700000>;
      };

      opp-15 {
        opp-hz = /bits/ 64 <1500000000>;
        opp-microvolt = <750000>;
      };

      opp-16 {
        opp-hz = /bits/ 64 <1600000000>;
        opp-microvolt = <770000>;
      };

      opp-17 {
        opp-hz = /bits/ 64 <1700000000>;
        opp-microvolt = <800000>;
      };

      opp-18 {
        opp-hz = /bits/ 64 <1800000000>;
        opp-microvolt = <840000>;
      };
    };
```

## Documentation/devicetree/bindings/crypto/sunplus,sp7350-crypto.yaml
```yaml
# SPDX-License-Identifier: (GPL-2.0-only OR BSD-2-Clause)
%YAML 1.2
---
$id: http://devicetree.org/schemas/crypto/sunplus,sp7350-crypto.yaml#
$schema: http://devicetree.org/meta-schemas/core.yaml#

title: Sunplus SP7350 CRYPTO engine

maintainers:
  - Qin Jian <qinjian@sunmedia.com.cn>

properties:
  compatible:
    const: sunplus,sp7350-crypto

  reg:
    maxItems: 1

  clocks:
    maxItems: 1

  resets:
    maxItems: 1

  interrupts:
    maxItems: 1

required:
  - compatible
  - reg
  - clocks
  - resets
  - interrupts

additionalProperties: false

examples:
  - |
    #include <dt-bindings/interrupt-controller/arm-gic.h>
    #include <dt-bindings/clock/sp-sp7350.h>
    #include <dt-bindings/reset/sp-sp7350.h>
    crypto: crypto@f8003d80 {
      compatible = "sunplus,sp7350-crypto";
      reg = <0xf8003d80 0x100>;
      clocks = <&clkc SEC>;
      resets = <&rstc RST_SEC>;
      interrupts = <GIC_SPI 48 IRQ_TYPE_LEVEL_HIGH>;
    };

...
```

## Documentation/devicetree/bindings/display/sunplus/panel-simple-dsi.yaml
```yaml
# SPDX-License-Identifier: (GPL-2.0-only OR BSD-2-Clause)
%YAML 1.2
---
$id: http://devicetree.org/schemas/display/sunplus/panel-simple-dsi.yaml#
$schema: http://devicetree.org/meta-schemas/core.yaml#

title: Sunplus simple DSI panels support

maintainers:
  - Daxun Jiang <dx.jiang@sunmedia.com.cn>

description: |
  This binding file is a collection of the DSI panels that
  requires only a single power-supply.
  There are optionally a backlight and an enable GPIO.
  The panel may use an OF graph binding for the association to the display,
  or it may be a direct child node of the display.

  If the panel is more advanced a dedicated binding file is required.

properties:

  compatible:
    enum:
      # compatible must be listed in alphabetical order, ordered by compatible.
      # The description in the comment is mandatory for each compatible.

        # Sunplus support LX technology 6.86"  IPS 480*(RGB)1280 TFT LCD panel
      - sunplus,lx-hxm0686tft-001
        # Sunplus support Zhejiang Xinli Optoelectronics technology 2.4" a-Si 240*(RGB)320 TFT LCD panel
      - sunplus,xinli-tcxd024iblon-2
        # Sunplus support wks technology 7.0 inch 800*(RGB)480 TFT-LCD panel
      - sunplus,wks-wks70wv055-wct

  reg:
    maxItems: 1
    description: DSI virtual channel

  backlight: true
  enable-gpios: true
  reset-gpios: true
  port: true

additionalProperties: false

required:
  - compatible
  - reg

examples:
  - |
    mipi-dsi {
      #address-cells = <1>;
      #size-cells = <0>;
      mipi_dsi_lcd@0 {
        compatible = "sunplus,lx-hxm0686tft-001";
        reg = <0>;

        port {
          panel_dsi_port: endpoint {
            remote-endpoint = <&dsi0_out0>;
          };
        };
      };
    };
```

## Documentation/devicetree/bindings/display/sunplus/sunplus,sp7350-crtc0.yaml
```yaml
# SPDX-License-Identifier: (GPL-2.0-only OR BSD-2-Clause)
%YAML 1.2
---
$id: http://devicetree.org/schemas/display/sunplus/sunplus,sp7350-crtc0.yaml#
$schema: http://devicetree.org/meta-schemas/core.yaml#

title: Sunplus sp7350-series SoC Display controller

maintainers:
  - Daxun Jiang <dx.jiang@sunmedia.com.cn>

description: |
  - The Display controller in Sunplus SoCs.

properties:
  compatible:
    const: sunplus,sp7350-crtc0

  reg:
    minItems: 1
    maxItems: 4

  interrupts:
    minItems: 1
    maxItems: 4

  port: true

required:
  - compatible
  - reg
  - interrupts
  - port

unevaluatedProperties: false

examples:
  - |
    #include <dt-bindings/interrupt-controller/irq.h>
    #include <dt-bindings/interrupt-controller/arm-gic.h>

    drm_crtc0: crtc0@f8005c80 {
      compatible = "sunplus,sp7350-crtc0";
      reg = <0x00 0xf8005c80 0x00 0x980>;

      interrupt-parent = <&gic>;
      interrupts = <GIC_SPI 104 IRQ_TYPE_LEVEL_HIGH>;

      port {
        crtc0_out: endpoint {
          remote-endpoint = <&dsi0_in0>;
        };
      };
    };
```

## Documentation/devicetree/bindings/display/sunplus/sunplus,sp7350-display-subsystem.yaml
```yaml
# SPDX-License-Identifier: (GPL-2.0-only)
%YAML 1.2
---
$id: http://devicetree.org/schemas/display/sunplus/sunplus,sp7350-display-subsystem.yaml#
$schema: http://devicetree.org/meta-schemas/core.yaml#

title: Sunplus sp7350-series DRM master device

maintainers:
  - Daxun Jiang <dx.jiang@sunmedia.com.cn>

description: |
  The Sunplus sp7350-series DRM master device is a virtual device needed to list all
  dsi devices or other display interface nodes that comprise the
  graphics subsystem.

properties:
  compatible:
    const: sunplus,sp7350-display-subsystem

required:
  - compatible

additionalProperties: false

examples:
  - |
    display-subsystem {
        compatible = "sunplus,sp7350-display-subsystem";
    };
```

## Documentation/devicetree/bindings/display/sunplus/sunplus,sp7350-dsi0.yaml
```yaml
# SPDX-License-Identifier: (GPL-2.0-only OR BSD-2-Clause)
%YAML 1.2
---
$id: http://devicetree.org/schemas/display/sunplus/sunplus,sp7350-dsi0.yaml#
$schema: http://devicetree.org/meta-schemas/core.yaml#

title: Sunplus sp7350-series SoC Display mipi-dsi controller

maintainers:
  - Daxun Jiang <dx.jiang@sunmedia.com.cn>

description: |
  - The MIPI-DSI controller in Sunplus SoCs.

properties:
  compatible:
    const: sunplus,sp7350-dsi0

  reg:
    maxItems: 4

  clocks:
    minItems: 2
    maxItems: 16

  clock-names:
    minItems: 2
    maxItems: 16

  resets:
    minItems: 2
    maxItems: 16

  reset-names:
    minItems: 2
    maxItems: 16

  ports:
    $ref: /schemas/graph.yaml#/properties/ports

required:
  - compatible
  - reg
  - clocks
  - clock-names
  - ports

unevaluatedProperties: false

examples:
  - |
    #include <dt-bindings/clock/sp-sp7350.h>
    #include <dt-bindings/reset/sp-sp7350.h>

    drm_dsi0: mipi-dsi@f8006600 {
      compatible = "sunplus,sp7350-dsi0";
      reg = <0x00 0xf8006600 0x00 0xb8>, <0x00 0xf8800180 0x00 0x80>;

      clocks = <&clkc DISPSYS>, <&clkc DMIX>, <&clkc TGEN>, <&clkc TCON>, <&clkc MIPITX>,
              <&clkc GPOST0>, <&clkc GPOST1>, <&clkc GPOST2>, <&clkc GPOST3>,
              <&clkc OSD0>, <&clkc OSD1>, <&clkc OSD2>, <&clkc OSD3>,
              <&clkc IMGREAD0>, <&clkc VSCL0>, <&clkc VPOST0>;
      clock-names = "clkc_dispsys", "clkc_dmix", "clkc_tgen", "clkc_tcon", "clkc_mipitx",
              "clkc_gpost0", "clkc_gpost1", "clkc_gpost2", "clkc_gpost3",
              "clkc_osd0", "clkc_osd1", "clkc_osd2", "clkc_osd3",
              "clkc_imgread0", "clkc_vscl0", "clkc_vpost0";
      resets = <&rstc RST_DISPSYS>, <&rstc RST_DMIX>, <&rstc RST_TGEN>, <&rstc RST_TCON>, <&rstc RST_MIPITX>,
              <&rstc RST_GPOST0>, <&rstc RST_GPOST1>, <&rstc RST_GPOST2>, <&rstc RST_GPOST3>,
              <&rstc RST_OSD0>, <&rstc RST_OSD1>, <&rstc RST_OSD2>, <&rstc RST_OSD3>,
              <&rstc RST_IMGREAD0>, <&rstc RST_VSCL0>, <&rstc RST_VPOST0>;
      reset-names = "rstc_dispsys", "rstc_dmix", "rstc_tgen", "rstc_tcon", "rstc_mipitx",
              "rstc_gpost0", "rstc_gpost1", "rstc_gpost2", "rstc_gpost3",
              "rstc_osd0", "rstc_osd1", "rstc_osd2", "rstc_osd3",
              "rstc_imgread0", "rstc_vscl0", "rstc_vpost0";

      ports {
        #address-cells = <1>;
        #size-cells = <0>;
        dsi0_in: port@0 {
          reg = <0>;
          #address-cells = <1>;
          #size-cells = <0>;
          dsi0_in0: endpoint@0 {
            remote-endpoint = <&crtc0_out>;
            reg = <0>;
          };
        };

        dsi0_out: port@1 {
          reg = <1>;
          #address-cells = <1>;
          #size-cells = <0>;
          dsi0_out0: endpoint@0 {
            reg = <0>;
          };
        };
      };
    };
```

## Documentation/devicetree/bindings/dma/sunplus,cbdma.yaml
```yaml
# SPDX-License-Identifier: (GPL-2.0-only OR BSD-2-Clause)
# Copyright (C) Sunplus Co., Ltd. 2021
%YAML 1.2
---
$id: http://devicetree.org/schemas/dma/sunplus,cbdma.yaml#
$schema: http://devicetree.org/meta-schemas/core.yaml#

title: Sunplus CB-DMA Controller

maintainers:
  - Cheng Chung Ho <cc.ho@sunplus.com>

description:
  Sunplus CB DMA Controller DT Binding

allOf:
  - $ref: dma-controller.yaml#

properties:
  compatible:
    enum:
      - sunplus,cb-dma
      - sunplus,cb-cdma

  reg:
    maxItems: 1

  reg-names:
    items:
      - const: cb_dma

  clocks:
    maxItems: 1

  resets:
    maxItems: 1

  interrupts:
    maxItems: 1

  sunplus,addrwidth:
    description: |
      DMA address width supported by hardware.
    $ref: /schemas/types.yaml#/definitions/uint32
    minimum: 32
    maximum: 64
    default: 32

  '#dma-cells':
    const: 1

patternProperties:
  '^.*$':
    if:
      type: object
    then:
      description: DMA channel nodes.

      properties:
        compatible:
          enum:
            - sunplus,cb-cdma-channel
            - sunplus,cb-dma-mm2s-channel
            - sunplus,cb-dma-s2mm-channel

        interrupts:
          maxItems: 1

        datawidth:
          description: The stream data width.
          minimum: 32
          maximum: 1024
          default: 32

      additionalProperties: false

additionalProperties: false

required:
  - compatible
  - reg
  - interrupts
  - sunplus,addrwidth

examples:
  - |
    #include <dt-bindings/interrupt-controller/irq.h>
    #include <dt-bindings/interrupt-controller/arm-gic.h>
    #include <dt-bindings/gpio/gpio.h>
    #include <dt-bindings/clock/sp-sp7350.h>
    #include <dt-bindings/reset/sp-sp7350.h>

    cbdma: dma-controller@f8000d00 {
        compatible = "sunplus,cb-cdma";
        reg = <0xf8000d00 0x80>;
        reg-names = "cb_dma";
        clocks = <&clkc CBDMA0>;
        resets = <&rstc RST_CBDMA0>;
        interrupt-parent = <&gic>;
        interrupts = <GIC_SPI 74 IRQ_TYPE_LEVEL_HIGH>;
        sunplus,addrwidth = <0x20>;
        #dma-cells = <1>;

        dma-channel-0 {
            compatible = "sunplus,cb-cdma-channel";
            interrupts = <GIC_SPI 74 IRQ_TYPE_LEVEL_HIGH>;
            datawidth = <0x20>;
        };
    };
...
```

## Documentation/devicetree/bindings/extcon/sunplus,extcon.yaml
```yaml
# SPDX-License-Identifier: GPL-2.0-only OR BSD-2-Clause
%YAML 1.2
---
$id: http://devicetree.org/schemas/extcon/sunplus,extcon.yaml#
$schema: http://devicetree.org/meta-schemas/core.yaml#

title: Sunplus usb3 CC (Configuration Channel) Logic device

maintainers:
  - ChingChou Huang <chingchou.huang@sunplus.com>

description: |
  Sunplus usb3 typeC orientation detection.
  The device node of Sunplus Extcon has following properties.
  
properties:
  compatible:
    const: linux,extcon-usb-gpio
  
  reg:
    items:
      - description: Base address and length of the uphy0 registers.

  pinctrl-names:
    description: |
      Names corresponding to the numbered pinctrl states.
      A pinctrl state named "default" must be defined.
    const: default
    
  pinctrl-0:
    description: A handle to the 'default' state of pin configuration
      
  id-gpios:
    deprecated: true
    description:
      GPIO pin (input) connected to the SP7350 99 pin.

required:
  - compatible
  - reg

additionalProperties: false

examples:
  - |
    #include <dt-bindings/gpio/gpio.h>
    extcon_dwc3drd: extcon_usb3@f8004a80 {
      compatible = "linux,extcon-usb-gpio";
      reg = <0xf8004a80 0x80>;
    };
...
```
