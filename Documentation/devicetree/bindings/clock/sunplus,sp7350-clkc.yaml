## Documentation/devicetree/bindings/media/sunplus,sp7350-vcodec-dmem.yaml
```yaml
# SPDX-License-Identifier: (GPL-2.0 OR BSD-2-Clause)
%YAML 1.2
---
$id: http://devicetree.org/schemas/media/sunplus,sp7350-vcodec-dmem.yaml#
$schema: http://devicetree.org/meta-schemas/core.yaml#

title: ML Inference Processor Video Codec Decoder Memory

maintainers:
  - Wang Zhou <wang.zhou@sunmedia.com.cn>

description:
  ML Inference Processor hardware video decoder memory in Sunplus SoCs.

properties:
  compatible:
    const: sunplus,sp7350-hantro-dmem

required:
  - compatible

additionalProperties: false

examples:
  - |
    #include <dt-bindings/interrupt-controller/irq.h>
    #include <dt-bindings/interrupt-controller/arm-gic.h>
    #include <dt-bindings/gpio/gpio.h>
    #include <dt-bindings/clock/sp-sp7350.h>
    #include <dt-bindings/reset/sp-sp7350.h>
    #include <dt-bindings/pinctrl/sppctl-sp7350.h>
    vcodec_dmem: video_codec_dmem {
      compatible = "sunplus,sp7350-hantro-dmem";
    };
```

## Documentation/devicetree/bindings/media/sunplus,sp7350-vcodec-emem.yaml
```yaml
# SPDX-License-Identifier: (GPL-2.0 OR BSD-2-Clause)
%YAML 1.2
---
$id: http://devicetree.org/schemas/media/sunplus,sp7350-vcodec-emem.yaml#
$schema: http://devicetree.org/meta-schemas/core.yaml#

title: ML Inference Processor Video Codec Encoder Memory

maintainers:
  - Wang Zhou <wang.zhou@sunmedia.com.cn>

description:
  ML Inference Processor hardware video encoder memory in Sunplus SoCs.

properties:
  compatible:
    const: sunplus,sp7350-hantro-emem

required:
  - compatible

additionalProperties: false

examples:
  - |
    #include <dt-bindings/interrupt-controller/irq.h>
    #include <dt-bindings/interrupt-controller/arm-gic.h>
    #include <dt-bindings/gpio/gpio.h>
    #include <dt-bindings/clock/sp-sp7350.h>
    #include <dt-bindings/reset/sp-sp7350.h>
    #include <dt-bindings/pinctrl/sppctl-sp7350.h>
    vcodec_emem: video_codec_emem {
      compatible = "sunplus,sp7350-hantro-emem";
    };
```

## Documentation/devicetree/bindings/media/sunplus,sp7350-vcodec-v4l2-mem.yaml
```yaml
# SPDX-License-Identifier: (GPL-2.0 OR BSD-2-Clause)
%YAML 1.2
---
$id: http://devicetree.org/schemas/media/sunplus,sp7350-vcodec-v4l2-mem.yaml#
$schema: http://devicetree.org/meta-schemas/core.yaml#

title: ML Inference Processor V4L2 Video Codec

maintainers:
  - Wang Zhou <wang.zhou@sunmedia.com.cn>

description:
  ML Inference Processor hardware video codec V4L2 interface in Sunplus SoCs.

properties:
  compatible:
    const: sunplus,sp7350-hantro-vsiv4l2

required:
  - compatible

additionalProperties: false

examples:
  - |
    #include <dt-bindings/interrupt-controller/irq.h>
    #include <dt-bindings/interrupt-controller/arm-gic.h>
    #include <dt-bindings/gpio/gpio.h>
    #include <dt-bindings/clock/sp-sp7350.h>
    #include <dt-bindings/reset/sp-sp7350.h>
    #include <dt-bindings/pinctrl/sppctl-sp7350.h>
    vcodec_v4l2_mem: video_codec_v4l2 {
      compatible = "sunplus,sp7350-hantro-vsiv4l2";
    };
```

## Documentation/devicetree/bindings/media/sunplus,sp7350-video-codec-dec.yaml
```yaml
# SPDX-License-Identifier: (GPL-2.0 OR BSD-2-Clause)
%YAML 1.2
---
$id: http://devicetree.org/schemas/media/sunplus,sp7350-video-codec-dec.yaml#
$schema: http://devicetree.org/meta-schemas/core.yaml#

title: ML Inference Processor Video Codec Decoder

maintainers:
  - Wang Zhou <wang.zhou@sunmedia.com.cn>

description:
  ML Inference Processor hardware video codec decodec in Sunplus SoCs.

properties:
  compatible:
    const: sunplus,sp7350-hantro-vc8000d

  reg:
    maxItems: 1

  interrupts:
    maxItems: 1

  clocks:
    maxItems: 1

  clock-names:
    const: clk_vc8000d

  resets:
    maxItems: 1

  reset-names:
    const: rstc_vc8000d

required:
  - compatible
  - reg
  - interrupts
  - clocks
  - clock-names
  - resets
  - reset-names

additionalProperties: false

examples:
  - |
    #include <dt-bindings/interrupt-controller/irq.h>
    #include <dt-bindings/interrupt-controller/arm-gic.h>
    #include <dt-bindings/gpio/gpio.h>
    #include <dt-bindings/clock/sp-sp7350.h>
    #include <dt-bindings/reset/sp-sp7350.h>
    #include <dt-bindings/pinctrl/sppctl-sp7350.h>
    video_codec_dec: hantro_vc8000d@f8168000 {
      compatible = "sunplus,sp7350-hantro-vc8000d";
      reg = <0xf8168000 0x1d8>;
      interrupt-parent = <&gic>;
      interrupts = <GIC_SPI 167 IRQ_TYPE_LEVEL_HIGH>;
      clocks = <&clkc VCD>;
      clock-names = "clk_vc8000d";
      resets = <&rstc RST_VCD>;
      reset-names = "rstc_vc8000d";
    };
```

## Documentation/devicetree/bindings/media/sunplus,sp7350-video-codec-enc.yaml
```yaml
# SPDX-License-Identifier: (GPL-2.0 OR BSD-2-Clause)
%YAML 1.2
---
$id: http://devicetree.org/schemas/media/sunplus,sp7350-video-codec-enc.yaml#
$schema: http://devicetree.org/meta-schemas/core.yaml#

title: ML Inference Processor Video Codec Encoder

maintainers:
  - Wang Zhou <wang.zhou@sunmedia.com.cn>

description:
  ML Inference Processor hardware video codec encode in Sunplus SoCs.

properties:
  compatible:
    const: sunplus,sp7350-hantro-vc8000e

  reg:
    maxItems: 1

  interrupts:
    maxItems: 1

  clocks:
    maxItems: 1

  clock-names:
    const: clk_vc8000e

  resets:
    maxItems: 1

  reset-names:
    const: rstc_vc8000e

required:
  - compatible
  - reg
  - interrupts
  - clocks
  - clock-names
  - resets
  - reset-names

additionalProperties: false

examples:
  - |
    #include <dt-bindings/interrupt-controller/irq.h>
    #include <dt-bindings/interrupt-controller/arm-gic.h>
    #include <dt-bindings/gpio/gpio.h>
    #include <dt-bindings/clock/sp-sp7350.h>
    #include <dt-bindings/reset/sp-sp7350.h>
    #include <dt-bindings/pinctrl/sppctl-sp7350.h>
    video_codec_enc: hantro_vc8000e@f80ff000 {
      compatible = "sunplus,sp7350-hantro-vc8000e";
      reg = <0xf80ff000 0xfff>;
      interrupt-parent = <&gic>;
      interrupts = <GIC_SPI 77 IRQ_TYPE_LEVEL_HIGH>;
      clocks = <&clkc VCE>;
      clock-names = "clk_vc8000e";
      resets = <&rstc RST_VCE>;
      reset-names = "rstc_vc8000e";
    };
```

## Documentation/devicetree/bindings/media/sunplus,sp7350-video-codec.yaml
```yaml
# SPDX-License-Identifier: (GPL-2.0 OR BSD-2-Clause)
%YAML 1.2
---
$id: http://devicetree.org/schemas/media/sunplus,sp7350-video-codec.yaml#
$schema: http://devicetree.org/meta-schemas/core.yaml#

title: ML Inference Processor Video Codec

maintainers:
  - Wang Zhou <wang.zhou@sunmedia.com.cn>

description:
  ML Inference Processor hardware video codec in Sunplus SoCs.

properties:
  compatible:
    const: sunplus,sp7350-hantro-codec

  clocks:
    maxItems: 1

  clock-names:
    const: clk_vcodec

  resets:
    maxItems: 8

  reset-names:
    items:
      - const: rstc_vcodec
      - const: rstc_vcl
      - const: rstc_vcl0
      - const: rstc_vcl1
      - const: rstc_vcl2
      - const: rstc_vcl3
      - const: rstc_vcl4
      - const: rstc_vcl5

required:
  - compatible
  - clocks
  - clock-names
  - resets
  - reset-names

additionalProperties: false

examples:
  - |
    #include <dt-bindings/interrupt-controller/irq.h>
    #include <dt-bindings/interrupt-controller/arm-gic.h>
    #include <dt-bindings/gpio/gpio.h>
    #include <dt-bindings/clock/sp-sp7350.h>
    #include <dt-bindings/reset/sp-sp7350.h>
    #include <dt-bindings/pinctrl/sppctl-sp7350.h>
    video_codec: video_codec {
      compatible = "sunplus,sp7350-hantro-codec";
      clocks = <&clkc VIDEO_CODEC>;
      clock-names = "clk_vcodec";
      resets = <&rstc RST_VIDEO_CODEC>, <&rstc RST_VCL>, <&rstc RST_VCL0>, <&rstc RST_VCL1>, <&rstc RST_VCL2>, <&rstc RST_VCL3>, <&rstc RST_VCL4>, <&rstc RST_VCL5>;
      reset-names = "rstc_vcodec", "rstc_vcl", "rstc_vcl0", "rstc_vcl1", "rstc_vcl2", "rstc_vcl3", "rstc_vcl4", "rstc_vcl5";
    };
```

## Documentation/devicetree/bindings/media/sunplus,sp7350-vin.yaml
```yaml
# SPDX-License-Identifier: (GPL-2.0-only OR BSD-2-Clause)
%YAML 1.2
---
$id: http://devicetree.org/schemas/media/sunplus,sp7350-vin.yaml#
$schema: http://devicetree.org/meta-schemas/core.yaml#

title: Sunplus Video Input (VIN)

maintainers:
  - JiaWei Li <jw.li@sunmedia.com.cn>
  - Cheng Chung Ho <cc.ho@sunplus.com>

description:
  The Video Input (VIN) device provides video input capabilities for the
  Sunplus devices.

  Each VIN instance has a single input that supports RGB and YUV video,
  with both external synchronization and BT.656 synchronization for the latter.
  Depending on the instance the VIN input is connected to a CSI-2 receiver.

properties:
  compatible:
    enum:
      - sunplus,sp7350-vin
  reg:
    maxItems: 2

  reg-names:
    items:
      - const: csiiw

  interrupts:
    maxItems: 2

  interrupt-names:
    items:
      - const: fs_irq
      - const: fe_irq

  clocks:
    maxItems: 1

  clock-names:
    items:
      - const: clk_csiiw

  power-domains:
    maxItems: 1

  resets:
    maxItems: 1

  reset-names:
    items:
      - const: rstc_csiiw

  sunplus,id:
    description: VIN channel number
    $ref: /schemas/types.yaml#/definitions/uint32
    minimum: 0
    maximum: 13

  ports:
    $ref: /schemas/graph.yaml#/properties/ports
    properties:
      port@1:
        $ref: /schemas/graph.yaml#/properties/port
        description:
          Input port node, multiple endpoints describing all the CSI-2
          modules connected the VIN.

        properties:
          endpoint@0:
            $ref: /schemas/graph.yaml#/properties/endpoint
            description: Endpoint connected to CSI0.

          endpoint@1:
            $ref: /schemas/graph.yaml#/properties/endpoint
            description: Endpoint connected to CSI1.

          endpoint@2:
            $ref: /schemas/graph.yaml#/properties/endpoint
            description: Endpoint connected to CSI2.

          endpoint@3:
            $ref: /schemas/graph.yaml#/properties/endpoint
            description: Endpoint connected to CSI3.

          endpoint@4:
            $ref: /schemas/graph.yaml#/properties/endpoint
            description: Endpoint connected to CSI4.

          endpoint@5:
            $ref: /schemas/graph.yaml#/properties/endpoint
            description: Endpoint connected to CSI5.

        anyOf:
          - required:
              - endpoint@0
          - required:
              - endpoint@1
          - required:
              - endpoint@2
          - required:
              - endpoint@3
          - required:
              - endpoint@4
          - required:
              - endpoint@5

required:
  - compatible
  - reg
  - interrupts
  - clocks
  - resets

additionalProperties: false

examples:
  # Device node example for Gen2 platform
  - |
    #include <dt-bindings/interrupt-controller/irq.h>
    #include <dt-bindings/interrupt-controller/arm-gic.h>
    #include <dt-bindings/gpio/gpio.h>
    #include <dt-bindings/clock/sp-sp7350.h>
    #include <dt-bindings/reset/sp-sp7350.h>
    vin0: video@f8005580 {
      compatible = "sunplus,sp7350-vin";
      reg = <0x0 0xf8005580 0x0 0x80>;
      reg-names = "csiiw";
      interrupt-parent = <&gic>;
      interrupts = <GIC_SPI 36 IRQ_TYPE_LEVEL_HIGH>,
            <GIC_SPI 37 IRQ_TYPE_LEVEL_HIGH>;
      interrupt-names = "fs_irq", "fe_irq";
      clocks = <&clkc VI0_CSIIW0>;
      clock-names = "clk_csiiw";
      resets = <&rstc RST_VI0_CSIIW0>;
      reset-names = "rstc_csiiw";
      sunplus,id = <0>;
      status = "okay";

      ports {
        #address-cells = <1>;
        #size-cells = <0>;
        port@1 {
          #address-cells = <1>;
          #size-cells = <0>;

          reg = <1>;
          vin0csi0: endpoint@0 {
            reg = <0>;
            remote-endpoint = <&csi0vin0>;
          };
        };
      };
    };
```

## Documentation/devicetree/bindings/media/sunplus-vip9000-galcore.yaml
```yaml
# SPDX-License-Identifier: (GPL-2.0 OR BSD-2-Clause)
%YAML 1.2
---
$id: http://devicetree.org/schemas/media/sunplus-vip9000-galcore.yaml#
$schema: http://devicetree.org/meta-schemas/core.yaml#

title: ML Inference Processor VIP9000-NPU

maintainers:
  - Luo Yang <yang.luo@sunmedia.com.cn>

description:
  - ML Inference Processor VIP9000-NPU hardware in Sunplus SoCs

properties:
  compatible:
    const: galcore

  reg:
    maxItems: 2

  reg-names:
    items:
      - const: galcore
      - const: gal_ios

  dev_name:
    const: galcore

  interrupts:
    items:
      - description: VIP9000 interrupt
    maxItems: 1

  clocks:
    maxItems: 1

  clock-names:
    const: clk_vip9000

  clock-frequency:
    description: Frequency of clock in Hz
    default: 900000000

  resets:
    maxItems: 1

  reset-names:
    const: rstc_vip9000

required:
  - compatible
  - reg
  - reg-name
  - dev_name
  - memory-region
  - interrupts
  - clocks
  - clock-names
  - clock-frequency
  - resets
  - reset-names

additionalProperties: false

examples:
  - |
    #include <dt-bindings/interrupt-controller/irq.h>
    #include <dt-bindings/interrupt-controller/arm-gic.h>
    #include <dt-bindings/clock/sp-sp7350.h>
    #include <dt-bindings/reset/sp-sp7350.h>
    #include <dt-bindings/pinctrl/sppctl-sp7350.h>
    galcore: galcore@f8140000 {
      compatible = "galcore";
      reg = <0x0 0xf8140000 0x0 0x20000>, <0x0 0xf880125c 0x0 0xff>;
      reg-name = "galcore","gal_ios";
      dev_name = "galcore";
      memory-region = <&npu_reserve>;
      interrupt-parent = <&gic>;
      interrupts = <GIC_SPI 165 IRQ_TYPE_LEVEL_HIGH>;
      clocks = <&clkc NPU>;
      clock-names = "clk_vip9000";
      clock-frequency = <900000000>;
      resets = <&rstc RST_NPU>;
      reset-names = "rstc_vip9000";
    };
```
