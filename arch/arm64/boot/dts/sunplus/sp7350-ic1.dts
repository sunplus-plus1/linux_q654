// SPDX-License-Identifier: (GPL-2.0 OR MIT)

//#define ENABLE_DMATX1
//#define ENABLE_DMATX2
//#define ENABLE_DMATX3
//#define ENABLE_DMATX6
//#define ENABLE_DMATX7

//#define MIPI_CSI_4VC
//#define OV5640_IN5

#define AP6275S_WIFI
//#define AP6275S_BT


#include "sp7350-common.dtsi"
#include <dt-bindings/input/input.h>

/ {
	model = "Sunplus SP7350 IC1";

	chosen {
		bootargs = "console=ttyS0,115200 earlycon loglevel=8 no_console_suspend ";
		stdout-path = "serial0:115200n8";
	};

	memory@0 {
		device_type = "memory";
		reg = <0x0 0x0        0x0 0xf0000000>;
		numa-node-id = <0>;
	};

	memory@100000000 {
		device_type = "memory";
		reg = <0x1 0x0        0x0 0x10000000>;
		numa-node-id = <1>;
	};

	distance-map {
		compatible = "numa-distance-map-v1";
		distance-matrix = <0 0 10>,
				  <0 1 20>,
				  <1 1 10>;
	};

	reserved-memory {
		#address-cells = <2>;
		#size-cells = <2>;
		ranges;

		/* Null-pointer protection reserve memory: 0x0-0x100000, total 1M */
		null_pointer_prot_reserve: null_pointer@0 {
			reg = <0x0 0x0 0x0 0x100000>;
			no-map;
		};

		/* warmboot reserve memory: 0x100000-0x200000, total 1M, load firmware in rproc */
		rproc_0_reserved: rproc0@100000 {
			compatible = "shared-dma-pool";
			reg = <0x0 0x100000 0x0 0x100000>;
			no-map;
		};

		/* TF-A reserve memory: 0x200000-0x2fffff, total 1M */
		tfa_reserve: tfa@200000 {
			reg = <0x0 0x200000 0x0 0x100000>;
			no-map;
		};

		/*OP-TEE reserve memory: 0x300000-0x4fffff, total 2M */
		optee_reserve: optee@300000 {
			reg = <0x0 0x300000 0x0 0x200000>;
			no-map;
		};

		/* mipi-csi rx dma cma reserve memory: 0x4f400000~0x507fffff, total 20M */
		mipicsirx_reserve: mipicsirx@4f400000 {
			compatible = "shared-dma-pool";
			reg = <0x0 0x4f400000 0x0 0x01400000>; // 4M alignment
			reusable;
		};

		/* 0x5080000-0x5be00000, total 182M no use */

		/* remoteproc reserve memory: 0x5be00000-0x5befffff, total 1M */
		vdev0buffer: vdev0buffer@5be00000 {
			compatible = "shared-dma-pool";
			reg = <0x0 0x5be00000 0x0 0x100000>;
			no-map;
		};
		vdev0vring0: vdev0vring0@5bf00000 {
			compatible = "shared-dma-pool";
			reg = <0x0 0x5bf00000 0x0 0x10000>;
			no-map;
		};
		vdev0vring1: vdev0vring1@5bf10000 {
			compatible = "shared-dma-pool";
			reg = <0x0 0x5bf10000 0x0 0x10000>;
			no-map;
		};
		vdev0_reserve: vdev0_reserve@5bf20000 {
			compatible = "shared-dma-pool";
			reg = <0x0 0x5bf20000 0x0 0xe0000>;
			no-map;
		};

		/* video encoder reserve memory: 0x60000000~0x73ffffff, total 320M */
		video_codec_encode: vcodec@60000000 {
			reg = <0x0 0x60000000 0x0 0x14000000>;
			no-map;
		};

		/* video decoder reserve memory: 0x74000000~0x77ffffff, total 64M */
		video_codec_decode: vcodec@74000000 {
			reg = <0x0 0x74000000 0x0 0x04000000>;
			no-map;
		};

		/* NPU reserve memory: 0x780000000 ~ 0x7fffffff, total 128M */
		npu_reserve: npu_reserve@78000000 {
			reg = <0x0 0x78000000 0x0 0x8000000>;
			no-map;
		};

		/* video v4l2 0x80000000~0x97fffff, total 384M */
		vcodec_v4l2: vcodec@80000000 {
			compatible = "shared-dma-pool";
			reg = <0x0 0x80000000 0x0 0x18000000>;
			reusable;
		};

		/* gdc reserve memory 0x98000000~0x9fffffff, total 128M */
		gdc_reserve: gdc@98000000 {
			compatible = "shared-dma-pool";
			reg = <0x0 0x98000000 0x0 0x8000000>;
			reusable;
		};

		/* CM4 reserve memory: 0xfa240000 ~ 0xfa29ffff, total 384K */
		rproc0runaddr: cm4runaddr@fa240000 {
			compatible = "shared-dma-pool";
			reg = <0x0 0xfa240000 0x0 0x60000>;
			no-map;
		};
	};

	clocks {
#ifdef OV5640_IN5
		ov5640_clk: camera-ov5640-clk {
			compatible = "fixed-clock";
			#clock-cells = <0>;
			clock-frequency = <24000000>;
		};
#endif
	};

	cpu_opp_table: opp-table {
		compatible = "operating-points-v2";
		opp-shared;

		opp-5 {
			opp-hz = /bits/ 64 <500000000>;
			opp-microvolt = <712500>;
		};

		opp-10 {
			opp-hz = /bits/ 64 <1000000000>;
			opp-microvolt = <712500>;
		};

		opp-15 {
			opp-hz = /bits/ 64 <1500000000>;
			opp-microvolt = <750000>;
		};

		opp-16 {
			opp-hz = /bits/ 64 <1600000000>;
			opp-microvolt = <770000>;
		};

		opp-17 {
			opp-hz = /bits/ 64 <1700000000>;
			opp-microvolt = <800000>;
		};

		opp-18 {
			opp-hz = /bits/ 64 <1800000000>;
			opp-microvolt = <840000>;
		};

		/*opp-19 {
			opp-hz = /bits/ 64 <1900000000>;
			opp-microvolt = <1000000>;
		};

		opp-20 {
			opp-hz = /bits/ 64 <2000000000>;
			opp-microvolt = <1000000>;
		};

		opp-21 {
			opp-hz = /bits/ 64 <2100000000>;
			opp-microvolt = <1000000>;
		};*/
	};

#ifdef OV5640_IN5
	ov5640_avdd_2v8: ov5640_avdd_2v8 {
		compatible = "regulator-fixed";
		regulator-name = "ov5640_avdd";
		regulator-min-microvolt = <2800000>;
		regulator-max-microvolt = <2800000>;
		regulator-always-on;
	};

	ov5640_dovdd_1v8: ov5640_dovdd_1v8 {
		compatible = "regulator-fixed";
		regulator-name = "ov5640_dovdd";
		regulator-min-microvolt = <1800000>;
		regulator-max-microvolt = <1800000>;
		regulator-always-on;
	};

	ov5640_dvdd_1v5: ov5640_dvdd_1v5 {
		compatible = "regulator-fixed";
		regulator-name = "ov5640_dvdd";
		regulator-min-microvolt = <1500000>;
		regulator-max-microvolt = <1500000>;
		regulator-always-on;
	};
#endif

#ifdef AP6275S_WIFI
	bcmdhd_wlan {
		compatible = "android,bcmdhd_wlan";
		pinctrl-names = "default";
		pinctrl-0 = <&gpio_int0_pins &ap6275s_ctrl_pins>;
		gpio_wl_reg_on = <&pctl 59 GPIO_ACTIVE_LOW>;
		interrupt-parent = <&gic>;
		interrupts = <GIC_SPI 0 IRQ_TYPE_LEVEL_HIGH>;
	};
	#ifdef AP6275S_BT
	rfkill_bluetooth {
		compatible = "rfkill-gpio";
		shutdown-gpios = <&pctl 57 GPIO_ACTIVE_HIGH>;
		rfkill-name = "bluetooth";
		rfkill-type = "bluetooth";
	};
	#endif
#endif

	running_led {
		compatible = "gpio-leds";
		pinctrl-names = "default";
		pinctrl-0 = <&running_leds_pins>;
		system-led {
			label = "system-led";
			gpios = <&pctl 0 GPIO_ACTIVE_HIGH>;
			default-state = "off";
			linux,default-trigger = "heartbeat";
		};
	};
};

&remoteproc0 {
	memory-region = <&rproc_0_reserved>, <&rproc0runaddr>, <&vdev0buffer>, <&vdev0vring0>, <&vdev0vring1>;
	firmware = "firmware";
};

&npu_core_0v8 {
	startup-delay-us = <5000>;
	off-on-delay-us = <5000>;
	pinctrl-names = "default";
	pinctrl-0 = <&npu_pwr_en_pins>;
	gpio = <&pctl 65 GPIO_ACTIVE_HIGH>;
	enable-active-high;
};

&gdc_video_isp_0v8 {
	pinctrl-names = "default";
	pinctrl-0 = <&video_codec_pwr_en_pins>;
	gpio = <&pctl 66 GPIO_ACTIVE_HIGH>;
	enable-active-high;
	regulator-boot-on;
	regulator-enable-ramp-delay = <50000>;
};

&uart0 {
	pinctrl-names = "default";
	pinctrl-0 = <&uart0_pins>;
};

&uart1 {
	pinctrl-names = "default";
	pinctrl-0 = <&uart1_pins &uart1_fc_pins>;
#ifndef AP6275S_WIFI
	#ifndef AP6275S_BT
	status = "disabled";
	#endif
#endif
};

&uart2 {
	pinctrl-names = "default";
	pinctrl-0 = <&uart2_pins &uart2_fc_pins>;
};

&uart3 {
	pinctrl-names = "default";
	pinctrl-0 = <&uart3_pins>;
	status = "disabled";
};

&uadbg {
	pinctrl-names = "default";
	pinctrl-0 = <&uadbg_pins>;
	status = "disabled";
};

&uart6 {
	pinctrl-names = "default";
	pinctrl-0 = <&uart6_pins>;
	status = "disabled";
};

&uart7 {
	pinctrl-names = "default";
	pinctrl-0 = <&uart7_pins>;
	status = "disabled";
};

&thermal {
	//status = "disabled";
};

&cpu_thermal_zone {
	polling-delay-passive = <5000>;
	polling-delay = <1000>;

	sustainable-power = <100000>;

	passive = <80>;
	trips {
		cpu_hott: cpu-hott {
			temperature = <120000>;
			hysteresis  = <1000>;
			type = "hot";
		};
		cpu_crit: cpu-crit {
			temperature = <125000>;
			hysteresis  = <0>;
			type = "critical";
		};
		cpu_trip0: cpu0 {
			temperature = <70000>;
			hysteresis = <2000>;
			type = "passive";
		};
		cpu_trip1: cpu1 {
			temperature = <80000>;
			hysteresis = <2000>;
			type = "active";
		};
	};
};

&ahbdma1 {
	dma-requests = <16>;
	chan_allocation_order = <1>;
	chan_priority = <1>;
	block_size = <0xfff>;
	dma-masters = <4>;
	data-width = <2 2 2 2>;
	multi-block = <0 0 0 0 0 0 0 0>;
	snps,max-burst-len = <128 128 128 128 128 128 128 128>;
	status = "disabled";
};

&spi_controller0 {
	pinctrl-names = "default";
	pinctrl-0 = <&spi_master0_pins>;
	status = "disabled";
};

&spi_controller1 {
	pinctrl-names = "default";
	pinctrl-0 = <&spi_master1_pins>;
	status = "disabled";
};

&spi_controller2 {
	pinctrl-names = "default";
	pinctrl-0 = <&spi_master2_pins>;
	status = "disabled";
};

&spi_controller3 {
	pinctrl-names = "default";
	pinctrl-0 = <&spi_master3_pins>;
	status = "disabled";
};

&spi_controller4 {
	pinctrl-names = "default";
	pinctrl-0 = <&spi_master4_pins>;
	//dmas = <&ahbdma1 6 0 0>,
	//       <&ahbdma1 7 0 0>;
	//dma-names = "rx", "tx";
	status = "disabled";

	spi@0 {
		compatible = "rohm,dh2228fv";
		spi-max-frequency = <5000000>;
		reg = <0x0>;
		status = "disabled";
	};
};

&spi_controller5 {
	pinctrl-names = "default";
	pinctrl-0 = <&spi_slave0_pins>;
	status = "disabled";
};

&i2c0 {
	i2c-sda-hold-time-ns = <1000>;
	//i2c-sda-falling-time-ns = <1>;
	//i2c-scl-falling-time-ns = <1>;
	clock-frequency = <400000>;
	pinctrl-names = "default";
	pinctrl-0 = <&i2c_combo0_pins>;
	status = "disabled";
};

&i2c1 {
	i2c-sda-hold-time-ns = <1000>;
	//i2c-sda-falling-time-ns = <1>;
	//i2c-scl-falling-time-ns = <1>;
	clock-frequency = <400000>;
	pinctrl-names = "default";
	pinctrl-0 = <&i2c_combo1_pins>;
};

&i2c2 {
	i2c-sda-hold-time-ns = <1000>;
	clock-frequency = <400000>;
	pinctrl-names = "default";
	pinctrl-0 = <&i2c_combo2_pins>;
	status = "disabled";
};

&i2c3 {
	i2c-sda-hold-time-ns = <1000>;
	clock-frequency = <400000>;
	pinctrl-names = "default";
	pinctrl-0 = <&i2c_combo3_pins>;
	status = "disabled";
};

&i2c4 {
	i2c-sda-hold-time-ns = <1000>;
	clock-frequency = <400000>;
	pinctrl-names = "default";
	pinctrl-0 = <&i2c_combo4_pins>;
	status = "okay";

	#address-cells = <1>;
	#size-cells = <0>;
};

&i2c5 {
	i2c-sda-hold-time-ns = <1000>;
	clock-frequency = <400000>;
	pinctrl-names = "default";
	pinctrl-0 = <&i2c_combo5_pins>;
	status = "disabled";
};

&i2c6 {
	i2c-sda-hold-time-ns = <1000>;
	clock-frequency = <400000>;
	pinctrl-names = "default";
	pinctrl-0 = <&i2c_combo6_pins>;
#if defined(OV5640_IN5)
	status = "okay";
#else
	status = "disabled";
#endif

#ifdef OV5640_IN5 /* Add ov5640 subnode in i2c6 */
	#address-cells = <1>;
	#size-cells = <0>;

	camera_5: ov5640@3c {
		compatible = "ovti,ov5640";
		reg = <0x3c>;
		clocks = <&ov5640_clk>;
		clock-names = "xclk";
		AVDD-supply = <&ov5640_avdd_2v8>;
		DOVDD-supply = <&ov5640_dovdd_1v8>;
		DVDD-supply = <&ov5640_dvdd_1v5>;

		port {
			ov5640_5: endpoint {
				remote-endpoint = <&csi2_5>;
				clock-lanes = <0>;
				data-lanes = <1 2>;
			};
		};
	};
#endif
};

&i2c7 {
	i2c-sda-hold-time-ns = <1000>;
	clock-frequency = <400000>;
	pinctrl-names = "default";
	pinctrl-0 = <&i2c_combo7_pins>;
	//status = "disabled";

	#address-cells = <1>;
	#size-cells = <0>;
	cpu_vdd_reg: regulator@60 {
		compatible = "tmi,sti8070x";
		reg = <0x60>;
		regulator-name = "sti8070x-buck";
		regulator-min-microvolt = <712500>;
		regulator-max-microvolt = <1100000>;
		regulator-allowed-modes = <0 1>;	// 0: auto mode (PFM) 1: force pwm mode
		regulator-initial-mode = <1>;
		regulator-always-on;
	};
};

&i2c8 {
	i2c-sda-hold-time-ns = <1000>;
	clock-frequency = <400000>;
	pinctrl-names = "default";
	pinctrl-0 = <&i2c_combo8_pins>;
	status = "disabled";
};

&i2c9 {
	i2c-sda-hold-time-ns = <1000>;
	clock-frequency = <400000>;
	pinctrl-names = "default";
	pinctrl-0 = <&i2c_combo9_pins>;
	status = "disabled";
};

&mipicsirx0 {
	status = "disabled";
};

&vin0 {
	status = "disabled";
};

&vin1 {
	status = "disabled";
};

&mipicsirx1 {
	status = "disabled";
};

&vin2 {
	status = "disabled";
};

&vin3 {
	status = "disabled";
};

&mipicsirx2 {
	status = "disabled";
};

&vin4 {
	status = "disabled";
};

&vin5 {
	status = "disabled";
};

#ifndef MIPI_CSI_4VC
&mipicsirx3 {
	status = "disabled";
};
#endif

&vin6 {
	status = "disabled";
};

&vin7 {
	status = "disabled";
};

&mipicsirx4 {
	status = "disabled";
};

&vin8 {
	status = "disabled";
};

&vin9 {
	status = "disabled";
};

&mipicsirx5 {
#if defined(OV5640_IN5)
	status = "okay";
#else
	status = "disabled";
#endif

	/* Virtual channel related properties */
	max_channels = <4>;
#if defined(OV5640_IN5)
	num_channels = <1>;
#else
	num_channels = <4>;
#endif

	ports {
		#address-cells = <1>;
		#size-cells = <0>;

		/* Input port node, sigle endpoint, connected to the CSI-2 transmitter */
#ifdef OV5640_IN5 /* Add ov5640 subnode in i2c6 */
		port@0 {
			reg = <0>;
			/* MIPI CSI-2 bus endpoint */
			csi2_5: endpoint {
				remote-endpoint = <&ov5640_5>;
				bus-type = <4>;
				clock-lanes = <0>;
				data-lanes = <1 2>;
			};
		};
#endif

		/* Output port node, multiple endpoints, connected to VIN modules */
		port@1 {
			#address-cells = <1>;
			#size-cells = <0>;

			reg = <1>;

			csi5vin10: endpoint@0 {
				reg = <0>;
				remote-endpoint = <&vin10csi5>;
			};

			csi5vin11: endpoint@1 {
				reg = <1>;
				remote-endpoint = <&vin11csi5>;
			};

			csi5vin12: endpoint@2 {
				reg = <2>;
				remote-endpoint = <&vin12csi5>;
			};

			csi5vin13: endpoint@3 {
				reg = <3>;
				remote-endpoint = <&vin13csi5>;
			};
		};
	};
};

&vin10 {
	memory-region = <&mipicsirx_reserve>;
#if defined(OV5640_IN5)
	status = "okay";
#else
	status = "disabled";
#endif

	ports {
		#address-cells = <1>;
		#size-cells = <0>;

		/* Input port node, default mode, connected to CSI-2 receivers */
		port@1 {
			#address-cells = <1>;
			#size-cells = <0>;

			reg = <1>;

			vin10csi5: endpoint@5 {
				reg = <5>;
				remote-endpoint = <&csi5vin10>;
			};
		};
	};
};

&vin11 {
	memory-region = <&mipicsirx_reserve>;
	status = "disabled";

	ports {
		#address-cells = <1>;
		#size-cells = <0>;

		/* Input port node, default mode, connected to CSI-2 receivers */
		port@1 {
			#address-cells = <1>;
			#size-cells = <0>;

			reg = <1>;

			vin11csi5: endpoint@5 {
				reg = <5>;
				remote-endpoint = <&csi5vin11>;
			};
		};
	};
};

&vin12 {
	memory-region = <&mipicsirx_reserve>;
	status = "disabled";

	ports {
		#address-cells = <1>;
		#size-cells = <0>;

		/* Input port node, default mode, connected to CSI-2 receivers */
		port@1 {
			#address-cells = <1>;
			#size-cells = <0>;

			reg = <1>;

			vin12csi5: endpoint@5 {
				reg = <5>;
				remote-endpoint = <&csi5vin12>;
			};
		};
	};
};

&vin13 {
	memory-region = <&mipicsirx_reserve>;
	status = "disabled";

	ports {
		#address-cells = <1>;
		#size-cells = <0>;

		/* Input port node, default mode, connected to CSI-2 receivers */
		port@1 {
			#address-cells = <1>;
			#size-cells = <0>;

			reg = <1>;

			vin13csi5: endpoint@5 {
				reg = <5>;
				remote-endpoint = <&csi5vin13>;
			};
		};
	};
};

&display { /* legacy display off */
	status = "disabled";
};
&fb_disp_device { /* legacy fb off */
	status = "disabled";
};
&display_subsystem { /* drm display on */
	status = "disabled";
};
&display_crtc0 { /* drm display on */
	status = "disabled";
};
&mipi_dsi0 { /* drm display on */
	status = "disabled";
};

&adc {
	//status = "disabled";
};

&pwm {
	pinctrl-names = "default";
	pinctrl-0 = <&pwm2_pins>;
	status = "disabled";
};

&rtc {
	status = "okay";
};

&dmac {
	snps,dma-masters = <2>;
	snps,data-width = <4>;
	snps,block-size = <4096 4096 4096 4096 4096 4096 4096 4096
			   4096 4096 4096 4096 4096 4096 4096 4096>;
	snps,priority = <0 1 2 3 4 5 6 7 8 9 10 11 12 13 14 15>;
	snps,axi-max-burst-len = <16>;
};

&ethernet {
	status = "disabled";
};

&mmc0 {
	max-frequency = <200000000>;
	#mmc-ddr-1_8v;
	mmc-hs200-1_8v;
	#mmc-hs400-1_8v;
	#mmc-hs400-enhanced-strobe;
};

&mmc1 {
	status = "disabled";
};

&sdio {
	pinctrl-names = "default";
	pinctrl-0 = <&sdio_pins>;
	delay-val = <0x777000>;
	max-frequency = <160000000>;
	//sunplus,high-segs;
	//sunplus,high-mem;
	non-removable;
	disable-wp;
	cap-sd-highspeed;
	sd-uhs-sdr12;
	sd-uhs-sdr25;
	sd-uhs-sdr50;
	sd-uhs-sdr104;
	sd-uhs-ddr50;
	cap-sdio-irq;
	keep-power-in-suspend;
	no-sd;
	no-mmc;
	#address-cells = <1>;
	#size-cells = <0>;
	//status = "disabled";
};

&sp_uphy0 {
};

&ehci0 {
};

&ohci0 {
};

&udc0 {
	dr_mode = "peripheral";
};

&otg {
	status = "disabled";
};

&extcon_dwc3drd {
	pinctrl-names = "default";
	pinctrl-0 = <&dwc3id_pins>;
	id-gpios = <&pctl 99 GPIO_ACTIVE_HIGH>;
};

&usbdrd_dwc3_0 {
	maximum-speed = "super-speed";
	dr_mode = "otg";
	usb-role-switch;
};

&u3phy0 {
	pinctrl-names = "default";
	pinctrl-0 = <&typec_pins>;
	typec-gpios = <&pctl 98 GPIO_ACTIVE_HIGH>;
};

&audio {
	pinctrl-names = "default";
	pinctrl-0 = <&aud_au_adc_data0_pins &aud_dac_xck_pins>;
	//status = "disabled";
};

&sp_spinor0 {
	status = "disabled";
};

&spinand0 {
	status = "disabled";
};

&paranand0 {
	status = "disabled";
};

&video_codec {
	video_codec-supply = <&gdc_video_isp_0v8>;
	video_codec_iso-supply = <&gdc_video_isp_iso>;
};

&vcodec_emem {
	memory-region = <&video_codec_encode>;
	video_codec-supply = <&gdc_video_isp_0v8>;
	video_codec_iso-supply = <&gdc_video_isp_iso>;
};

&vcodec_dmem {
	memory-region = <&video_codec_decode>;
	video_codec-supply = <&gdc_video_isp_0v8>;
	video_codec_iso-supply = <&gdc_video_isp_iso>;
};

&vcodec_v4l2_mem {
	memory-region = <&vcodec_v4l2>;
};

&galcore {
	memory-region = <&npu_reserve>;
	npu_core-supply = <&npu_core_0v8>;
	status = "okay";
};

&gdc {
	memory-region = <&gdc_reserve>;
	iso-supply = <&gdc_video_isp_iso>;
	power-supply = <&gdc_video_isp_0v8>;
};

&watchdog {
	timeout-sec = <10>;
};

&stc {
	stc-src-sel = /bits/ 8 <1>;
	stc-freq = <100000>;
};
&stc_timer0 {
	timer-mode = /bits/ 8 <1>;
};
&stc_timer1 {
	timer-mode = /bits/ 8 <1>;
};
&stc_timer2 {
	timer-mode = /bits/ 8 <1>;
};
&stc_timer3 {
	timer-mode = /bits/ 8 <1>;
};

&stc_av0 {
	stc-src-sel = /bits/ 8 <1>;
	stc-freq = <100000>;
};
&stc_av0_timer0 {
	timer-mode = /bits/ 8 <1>;
};
&stc_av0_timer1 {
	timer-mode = /bits/ 8 <1>;
};
&stc_av0_timer2 {
	timer-mode = /bits/ 8 <1>;
};
&stc_av0_timer3 {
	timer-mode = /bits/ 8 <1>;
};

&stc_av1 {
	stc-src-sel = /bits/ 8 <1>;
	stc-freq = <100000>;
};
&stc_av1_timer0 {
	timer-mode = /bits/ 8 <1>;
};
&stc_av1_timer1 {
	timer-mode = /bits/ 8 <1>;
};
&stc_av1_timer2 {
	timer-mode = /bits/ 8 <1>;
};
&stc_av1_timer3 {
	timer-mode = /bits/ 8 <1>;
};

&stc_av2 {
	stc-src-sel = /bits/ 8 <1>;
	stc-freq = <100000>;
};
&stc_av2_timer0 {
	timer-mode = /bits/ 8 <1>;
};
&stc_av2_timer1 {
	timer-mode = /bits/ 8 <1>;
};
&stc_av2_timer2 {
	timer-mode = /bits/ 8 <1>;
};
&stc_av2_timer3 {
	timer-mode = /bits/ 8 <1>;
};

&stc_av4 {
	stc-src-sel = /bits/ 8 <1>;
	stc-freq = <100000>;
};
&stc_av4_timer0 {
	timer-mode = /bits/ 8 <1>;
};
&stc_av4_timer1 {
	timer-mode = /bits/ 8 <1>;
};
&stc_av4_timer2 {
	timer-mode = /bits/ 8 <1>;
};
&stc_av4_timer3 {
	timer-mode = /bits/ 8 <1>;
};

&pctl {
	sunplus,ms-dvio-group-0 = "1V8";
	sunplus,ms-dvio-group-1 = "1V8";
	sunplus,ms-dvio-ao-group-0 = "1V8";
	sunplus,ms-dvio-ao-group-1 = "1V8";
	sunplus,ms-dvio-ao-group-2 = "1V8";

	sunplus,ao-pin-prescale = <2500>;
	sunplus,ao-pin-debounce = <10>;

	emmc_pins: pinmux_emmc-pins {
		function = "EMMC";
		groups = "EMMC";
		drive-strength-microamp = <SPPCTRL_DVIO_DRV_IOH_22700_IOL_27900UA>;	// DS=7 for HS200
		//drive-strength-microamp = <SPPCTRL_DVIO_DRV_IOH_30300_IOL_37200UA>;	// DS=10 for HS400
	};

	sdcard_pins: pinmux_sdcard-pins {
		function = "SD_CARD";
		groups = "SD_CARD";
		drive-strength-microamp = <SPPCTRL_DVIO_DRV_IOH_17700_IOL_21800UA>;
	};

	sdcard_cd_pins: pinmux_sdcard_cd-pins {
		function = "GPIO";
		pins = "GPIO17";
	};

	typec_pins: pinmux_typec-pins {
		function = "GPIO";
		pins = "GPIO98";
	};

	audcodec_pins: pinmux_audcodec-pins {
		function = "GPIO";
		pins = "GPIO27";
		output-high;
	};

	dwc3id_pins: pinmux_usb3id-pins {
		function = "GPIO";
		pins = "GPIO99";
	};

	npu_pwr_en_pins: pinmux_video_npu_pwr_en-pins {
		function = "GPIO";
		pins = "GPIO65";
	};

	video_codec_pwr_en_pins: pinmux_video_codec_pwr_en-pins {
		function = "GPIO";
		pins = "GPIO66";
	};

	uart0_pins: pinmux_uart0-pins {
		function = "UART0";
		groups = "UART0_X1";
		drive-strength-microamp = <SPPCTRL_DVIO_DRV_IOH_15200_IOL_18700UA>;
	};

	uart1_pins: pinmux_uart1-pins {
		function = "UART1";
		groups = "UART1_X1";
		drive-strength-microamp = <SPPCTRL_DVIO_DRV_IOH_15200_IOL_18700UA>;
	};
	uart1_fc_pins: pinmux_uart1_fc-pins {
		function = "UART1_FC";
		groups = "UART1_FC_X1";
		drive-strength-microamp = <SPPCTRL_DVIO_DRV_IOH_15200_IOL_18700UA>;
	};

	uart2_pins: pinmux_uart2-pins {
		function = "UART2";
		groups = "UART2_X2";
		drive-strength-microamp = <SPPCTRL_DVIO_DRV_IOH_15200_IOL_18700UA>;
	};
	uart2_fc_pins: pinmux_uart2_fc-pins {
		function = "UART2_FC";
		groups = "UART2_FC_X2";
		drive-strength-microamp = <SPPCTRL_DVIO_DRV_IOH_15200_IOL_18700UA>;
	};

	uart3_pins: pinmux_uart3-pins {
		function = "UART3";
		groups = "UART3_X1";
		drive-strength-microamp = <SPPCTRL_DVIO_DRV_IOH_15200_IOL_18700UA>;
	};

	uadbg_pins: pinmux_uadbg-pins {
		function = "UADBG";
		groups = "UADBG";
		drive-strength-microamp = <SPPCTRL_GPIO_DRV_IOH_6600_IOL_6600UA>;
	};

	uart6_pins: pinmux_uart6-pins {
		function = "UART6";
		groups = "UART6_X1";
		drive-strength-microamp = <SPPCTRL_GPIO_DRV_IOH_6600_IOL_6600UA>;
	};

	uart7_pins: pinmux_uart7-pins {
		function = "UART7";
		groups = "UART7";
		drive-strength-microamp = <SPPCTRL_GPIO_DRV_IOH_6600_IOL_6600UA>;
	};

	spi_master0_pins: pinmux_spi_master0-pins {
		function = "SPI_MASTER0";
		groups = "SPI_MASTER0_X1";
		drive-strength-microamp = <SPPCTRL_DVIO_DRV_IOH_15200_IOL_18700UA>;
	};
	spi_master1_pins: pinmux_spi_master1-pins {
		function = "SPI_MASTER1";
		groups = "SPI_MASTER1_X1";
		drive-strength-microamp = <SPPCTRL_GPIO_DRV_IOH_14800_IOL_14800UA>;
	};
	spi_master2_pins: pinmux_spi_master2-pins {
		function = "SPI_MASTER2";
		groups = "SPI_MASTER2";
		drive-strength-microamp = <SPPCTRL_GPIO_DRV_IOH_14800_IOL_14800UA>;
	};
	spi_master3_pins: pinmux_spi_master3-pins {
		function = "SPI_MASTER3";
		groups = "SPI_MASTER3_X2";
		drive-strength-microamp = <SPPCTRL_DVIO_DRV_IOH_15200_IOL_18700UA>;
	};
	spi_master4_pins: pinmux_spi_master4-pins {
		function = "SPI_MASTER4";
		groups = "SPI_MASTER4";
		drive-strength-microamp = <SPPCTRL_DVIO_DRV_IOH_15200_IOL_18700UA>;
	};
	spi_slave0_pins: pinmux_spi_slave0-pins {
		function = "SPI_SLAVE0";
		groups = "SPI_SLAVE0_X1";
		drive-strength-microamp = <SPPCTRL_GPIO_DRV_IOH_9900_IOL_9900UA>;
	};

	i2c_combo0_pins: pinmux_i2c_combo0-pins {
		function = "I2C_COMBO0";
		groups = "I2C_COMBO0_X1";
		drive-strength-microamp = <SPPCTRL_DVIO_DRV_IOH_15200_IOL_18700UA>;
	};
	i2c_combo1_pins: pinmux_i2c_combo1-pins {
		function = "I2C_COMBO1";
		groups = "I2C_COMBO1";
		drive-strength-microamp = <SPPCTRL_DVIO_DRV_IOH_15200_IOL_18700UA>;
	};
	i2c_combo2_pins: pinmux_i2c_combo2-pins {
		function = "I2C_COMBO2";
		groups = "I2C_COMBO2_X1";
		drive-strength-microamp = <SPPCTRL_DVIO_DRV_IOH_15200_IOL_18700UA>;
	};
	i2c_combo3_pins: pinmux_i2c_combo3-pins {
		function = "I2C_COMBO3";
		groups = "I2C_COMBO3";
		drive-strength-microamp = <SPPCTRL_GPIO_DRV_IOH_9900_IOL_9900UA>;
	};
	i2c_combo4_pins: pinmux_i2c_combo4-pins {
		function = "I2C_COMBO4";
		groups = "I2C_COMBO4";
		drive-strength-microamp = <SPPCTRL_GPIO_DRV_IOH_9900_IOL_9900UA>;
	};
	i2c_combo5_pins: pinmux_i2c_combo5-pins {
		function = "I2C_COMBO5";
		groups = "I2C_COMBO5";
		drive-strength-microamp = <SPPCTRL_GPIO_DRV_IOH_9900_IOL_9900UA>;
	};
	i2c_combo6_pins: pinmux_i2c_combo6-pins {
		function = "I2C_COMBO6";
		groups = "I2C_COMBO6_X1";
		drive-strength-microamp = <SPPCTRL_GPIO_DRV_IOH_16400_IOL_16500UA>;
	};
	i2c_combo7_pins: pinmux_i2c_combo7-pins {
		function = "I2C_COMBO7";
		groups = "I2C_COMBO7_X1";
		drive-strength-microamp = <SPPCTRL_GPIO_DRV_IOH_9900_IOL_9900UA>;
	};
	i2c_combo8_pins: pinmux_i2c_combo8-pins {
		function = "I2C_COMBO8";
		groups = "I2C_COMBO8_X1";
		drive-strength-microamp = <SPPCTRL_GPIO_DRV_IOH_9900_IOL_9900UA>;
	};
	i2c_combo9_pins: pinmux_i2c_combo9-pins {
		function = "I2C_COMBO9";
		groups = "I2C_COMBO9_X1";
		drive-strength-microamp = <SPPCTRL_GPIO_DRV_IOH_9900_IOL_9900UA>;
	};

	gmac_pins: pinmux_gmac-pins {
		pinmux{
			function = "GMAC";
			groups = "GMAC_RGMII";
		};
		pinconf0 {
			pins = "GPIO7","GPIO8","GPIO10","GPIO11","GPIO15","GPIO16";
			drive-strength-microamp = <SPPCTRL_GPIO_DRV_IOH_16400_IOL_16500UA>;
		};
		pinconf1 {
			pins = "GPIO3","GPIO4","GPIO5","GPIO6","GPIO13","GPIO14";
			drive-strength-microamp = <SPPCTRL_GPIO_DRV_IOH_8200_IOL_8300UA>;
		};
		pinconf3 {
			pins = "GPIO9","GPIO12";
			drive-strength-microamp = <SPPCTRL_GPIO_DRV_IOH_8200_IOL_8300UA>;
		};
	};

	sdio_pins: pinmux_sdio-pins {
		function = "SDIO";
		groups = "SDIO";
		drive-strength-microamp = <SPPCTRL_DVIO_DRV_IOH_17700_IOL_21800UA>;
	};

	pwm0_pins: pinmux_pwm0-pins {
		function = "PWM0";
		groups = "PWM0_X1";
		drive-strength-microamp = <SPPCTRL_DVIO_DRV_IOH_15200_IOL_18700UA>;
	};

	pwm1_pins: pinmux_pwm1-pins {
		function = "PWM1";
		groups = "PWM1_X1";
		drive-strength-microamp = <SPPCTRL_DVIO_DRV_IOH_15200_IOL_18700UA>;
	};

	pwm2_pins: pinmux_pwm2-pins {
		function = "PWM2";
		groups = "PWM2_X1";
		drive-strength-microamp = <SPPCTRL_DVIO_DRV_IOH_15200_IOL_18700UA>;
	};

	pwm3_pins: pinmux_pwm3-pins {
		function = "PWM3";
		groups = "PWM3_X1";
		drive-strength-microamp = <SPPCTRL_DVIO_DRV_IOH_15200_IOL_18700UA>;
	};

	aud_tdmtx_xck_pins: pinmux_aud_tdmtx_xck-pins {
		function = "AUD_TDMTX_XCK";
		groups = "AUD_TDMTX_XCK";
		drive-strength-microamp = <SPPCTRL_GPIO_DRV_IOH_9900_IOL_9900UA>;
	};
	aud_dac_xck_pins: pinmux_aud_dac_xck-pins {
		function = "AUD_DAC_XCK";
		groups = "AUD_DAC_XCK";
		drive-strength-microamp = <SPPCTRL_GPIO_DRV_IOH_9900_IOL_9900UA>;
	};
	aud_dac_xck1_pins: pinmux_aud_dac_xck1-pins {
		function = "AUD_DAC_XCK1";
		groups = "AUD_DAC_XCK1";
		drive-strength-microamp = <SPPCTRL_DVIO_DRV_IOH_10100_IOL_12500UA>;
	};
	aud_au2_data0_pins: pinmux_aud_au2_data0-pins {
		function = "AUD_AU2_DATA0";
		groups = "AUD_AU2_DATA0";
		drive-strength-microamp = <SPPCTRL_GPIO_DRV_IOH_9900_IOL_9900UA>;
	};
	aud_au1_data0_pins: pinmux_aud_au1_data0-pins {
		function = "AUD_AU1_DATA0";
		groups = "AUD_AU1_DATA0";
		drive-strength-microamp = <SPPCTRL_DVIO_DRV_IOH_10100_IOL_12500UA>;
	};
	aud_au2_ck_pins: pinmux_aud_au2_ck-pins {
		function = "AUD_AU2_CK";
		groups = "AUD_AU2_CK";
		drive-strength-microamp = <SPPCTRL_GPIO_DRV_IOH_9900_IOL_9900UA>;
	};
	aud_au1_ck_pins: pinmux_aud_au1_ck-pins {
		function = "AUD_AU1_CK";
		groups = "AUD_AU1_CK";
		drive-strength-microamp = <SPPCTRL_DVIO_DRV_IOH_10100_IOL_12500UA>;
	};
	aud_au_adc_data0_pins: pinmux_aud_au_adc_data0-pins {
		function = "AUD_AU_ADC_DATA0";
		groups = "AUD_AU_ADC_DATA0_X1";
		drive-strength-microamp = <SPPCTRL_GPIO_DRV_IOH_9900_IOL_9900UA>;
	};
	aud_adc2_data0_pins: pinmux_aud_adc2_data0-pins {
		function = "AUD_ADC2_DATA0";
		groups = "AUD_ADC2_DATA0";
		drive-strength-microamp = <SPPCTRL_GPIO_DRV_IOH_9900_IOL_9900UA>;
	};
	aud_adc1_data0_pins: pinmux_aud_adc1_data0-pins {
		function = "AUD_ADC1_DATA0";
		groups = "AUD_ADC1_DATA0";
		drive-strength-microamp = <SPPCTRL_DVIO_DRV_IOH_10100_IOL_12500UA>;
	};
	aud_tdm_pins: pinmux_aud_tdm-pins {
		function = "AUD_TDM";
		groups = "AUD_TDM";
		drive-strength-microamp = <SPPCTRL_GPIO_DRV_IOH_9900_IOL_9900UA>;
	};
	spdif_in_pins: pinmux_spdif_in-pins {
		function = "SPDIF_IN";
		groups = "SPDIF_IN_X1";
	};
	spdif_out_pins: pinmux_spdif_out-pins {
		function = "SPDIF_OUT";
		groups = "SPDIF_OUT_X1";
	};

	gpio_int0_pins: pinmux_gpio_int0-pins {
		function = "INT0";
		groups = "INT0_X1";
	};
	gpio_int1_pins: pinmux_gpio_int1-pins {
		function = "INT1";
		groups = "INT1_X1";
	};
	gpio_int2_pins: pinmux_gpio_int2-pins {
		function = "INT2";
		groups = "INT2_X1";
	};
	gpio_int3_pins: pinmux_gpio_int3-pins {
		function = "INT3";
		groups = "INT3_X1";
	};
	gpio_int4_pins: pinmux_gpio_int4-pins {
		function = "INT4";
		groups = "INT4_X1";
	};
	gpio_int5_pins: pinmux_gpio_int5-pins {
		function = "INT5";
		groups = "INT5_X1";
	};
	gpio_int6_pins: pinmux_gpio_int6-pins {
		function = "INT6";
		groups = "INT6_X1";
	};
	gpio_int7_pins: pinmux_gpio_int7-pins {
		function = "INT7";
		groups = "INT7_X1";
	};

	gpio_ao_int0_pins: pinmux_gpio_ao_int0-pins {
		function = "GPIO_AO_INT0";
		groups = "GPIO_AO_INT0_X1";
		sunplus,ao-pins = <
			SPPCTL_AOIOPAD(0, SPPCTL_AOPIN_OUT0)
			SPPCTL_AOIOPAD(1, SPPCTL_AOPIN_OUT1)
		>;
	};
	gpio_ao_int1_pins: pinmux_gpio_ao_int1-pins {
		function = "GPIO_AO_INT1";
		groups = "GPIO_AO_INT1_X1";
		sunplus,ao-pins = <
			SPPCTL_AOIOPAD(8, 0)
			SPPCTL_AOIOPAD(15, SPPCTL_AOPIN_DEB)
		>;
	};
	gpio_ao_int2_pins: pinmux_gpio_ao_int2-pins {
		function = "GPIO_AO_INT2";
		groups = "GPIO_AO_INT2_X1";
		sunplus,ao-pins = < SPPCTL_AOIOPAD(16, 0) >;
	};
	gpio_ao_int3_pins: pinmux_gpio_ao_int3-pins {
		function = "GPIO_AO_INT3";
		groups = "GPIO_AO_INT3_X1";
		sunplus,ao-pins = < SPPCTL_AOIOPAD(31, 0) >;
	};

	running_leds_pins: pinmux_running_leds-pins {
		function = "GPIO";
		pins = "GPIO0";
	};

#ifdef AP6275S_WIFI
	ap6275s_ctrl_pins: ap6275s_ctrl-pins {
		function = "GPIO";
		pins = "GPIO59", "GPIO57";
	};
#endif
};
