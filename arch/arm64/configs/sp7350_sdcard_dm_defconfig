## drivers/media/platform/sunplus/display/sp7350/Kconfig
```kconfig
# SPDX-License-Identifier: GPL-2.0

config VIDEO_SP7350_DISP
	tristate "Sunplus SP7350 Display Driver"
	depends on VIDEO_DEV && V4L_PLATFORM_DRIVERS && SOC_SP7350
	select VIDEOBUF2_DMA_CONTIG
	select VIDEOBUF2_VMALLOC
	# select FB_SP7350
	default n
	help
	  Support for the Sunplus SP7350 display driver.

config VIDEO_SP7350_DISP_DEBUG
	bool "External Debug Support"
	depends on VIDEO_SP7350_DISP
	help
	  Say Y here, if you want to have debug support.
	  Debug function is reserved for display further check.
	  echo "dump all" > /sys/module/display_sp7350/parameter/debug
	  can show more detailed information for display driver.

config VIDEO_SP7350_DISP_PI_PANEL
	bool "Built-in Raspberry Pi 7-inch Touch-screen I2C Controller"
	depends on VIDEO_SP7350_DISP
	default n
	help
	  Say Y here, if you want to use Raspberry Pi 7-inch touch-screen
	  800x480 DSI panel.
	  Note that this I2C controller only supports DSI function.
	  It does not include touch-screen function.

config VIDEO_SP7350_DISP_LT8912B
	bool "Built-in LT8912B DSI-to-HDMI Bridge (I2C) Controller"
	depends on VIDEO_SP7350_DISP
	default n
	help
	  Say Y here, if you want to use Lontium LT8912B DSI-to-HDMI bridge.
```

## drivers/media/platform/sunplus/gdc/Kconfig
```kconfig
# SPDX-License-Identifier: GPL-2.0
#
# Sunplus Geometric Distortion Correction driver configuration
#

config VIDEO_SUNPLUS_GDC
	bool "Sunplus Geometric Distortion Correction Driver"
	depends on V4L_MEM2MEM_DRIVERS
	depends on VIDEO_DEV
	select VIDEOBUF2_DMA_CONTIG
	select V4L2_MEM2MEM_DEV
	default y
	help
	  Support for the Sunplus Geometric Distortion Correction driver

config VIDEO_SUNPLUS_GDC_SP7350
	bool "Geometric Distortion Correction Driver for SP7350"
	depends on VIDEO_SUNPLUS_GDC
	default y
	help
	  Support for the Sunplus SP7350 Geometric Distortion Correction driver
```

## drivers/media/platform/sunplus/isp/Kconfig
```kconfig
# SPDX-License-Identifier: GPL-2.0
#
# Sunplus ISP driver configuration
#

config VIDEO_SUNPLUS_ISP_DRV
	tristate "Sunplus SP7350 ISP Driver"
	depends on VIDEO_DEV && OF && SOC_SP7350
	select MEDIA_CONTROLLER
	select VIDEO_V4L2_SUBDEV_API
	select RESET_CONTROLLER
	select V4L2_FWNODE
	select VIDEOBUF2_DMA_CONTIG
	select V4L2_MEM2MEM_DEV
	help
	  Support for Sunplus ISP on SP7350 SoC.

	  To compile this driver as a module, choose M here: the
	  module will be called isp.
```

## drivers/media/platform/sunplus/mipicsi/Kconfig
```kconfig
# SPDX-License-Identifier: GPL-2.0
#
# Sunplus MIPI/CSI RX driver configuration
#

config VIDEO_SUNPLUS_SP7350_CSI2
	tristate "Sunplus SP7350 MIPI CSI-2 RX Driver"
	depends on VIDEO_V4L2 && OF
	depends on SOC_SP7350
	select MEDIA_CONTROLLER
	select VIDEO_V4L2_SUBDEV_API
	select RESET_CONTROLLER
	select V4L2_FWNODE
	help
	  Support for Sunplus MIPI CSI-2 receiver.
	  Supports SP7350 SoC.

	  To compile this driver as a module, choose M here: the
	  module will be called sp-mipi-sp7350.

config VIDEO_SUNPLUS_SP7350_VIN
	tristate "Sunplus SP7350 Video Input (VIN) Driver"
	depends on VIDEO_V4L2 && OF
	depends on SOC_SP7350
	select MEDIA_CONTROLLER
	select VIDEO_V4L2_SUBDEV_API
	select VIDEOBUF2_DMA_CONTIG
	select V4L2_FWNODE
	help
	  Support for Sunplus Video Input (VIN) driver.
	  Supports SP7350 SoC.

	  To compile this driver as a module, choose M here: the
	  module will be called sp-vin-sp7350.
```

## drivers/media/platform/sunplus/stereo_m2m/Kconfig
```kconfig
# SPDX-License-Identifier: GPL-2.0
#
# Sunplus Stereo driver configuration
#

config STEREO_SUNPLUS_DRV
	tristate "Sunplus SP7350 stereo (m2m) driver"
	select MEDIA_CONTROLLER
	select VIDEO_V4L2
	select VIDEO_V4L2_SUBDEV_API
	select VIDEOBUF2_CORE
	select V4L2_MEM2MEM_DEV
	select V4L2_FWNODE
	select VIDEOBUF2_DMA_CONTIG
	depends on SOC_SP7350
	help
	  This is a v4l2 driver for Sunplus stereo.
```

## drivers/media/platform/sunplus/tsp/Kconfig
```kconfig
# SPDX-License-Identifier: GPL-2.0
#
# Sunplus TSP driver configuration
#

config TSP_SUNPLUS_DRV
	tristate "Sunplus SP7350 TSP driver"
	depends on SOC_SP7350
	help
	  This is a v4l2 driver for Sunplus TSP.
```

## drivers/media/platform/sunplus/videocodec/Kconfig
```kconfig
config VIDEO_HANTRO_DECODER
	tristate "HANTRO VC8000NanoD video decoder driver"
	default n
	help
		Support for the hardware decoder driver.

config VIDEO_HANTRO_ENCODER
	tristate "HANTRO VC8000NanoE video encoder driver"
	default n
	help
		Support for the hardware encoder driver.

config VIDEO_HANTRO_DECODER_MEM
	tristate "HANTRO VC8000NanoD video decoder memory driver"
	default n
	help
		Support for the hardware decoder memory driver.

config VIDEO_HANTRO_ENCODER_MEM
	tristate "HANTRO VC8000NanoE video encoder memory driver"
	default n
	help
		Support for the hardware encoder memory driver.

config VIDEO_HANTRO_V4L2_DECODER
	tristate "HANTRO VC8000NanoD video decoder v4l2 driver"
	select VIDEOBUF2_DMA_CONTIG
	select VIDEO_HANTRO_DECODER_MEM
	select VIDEO_HANTRO_DECODER
	default n
	help
		Support for the hardware decoder v4l2 driver.

config VIDEO_HANTRO_V4L2_ENCODER
	tristate "HANTRO VC8000NanoE video encoder v4l2 driver"
	select VIDEOBUF2_DMA_CONTIG 
	select VIDEO_HANTRO_ENCODER_MEM
	select VIDEO_HANTRO_ENCODER
	default n
	help
		Support for the hardware encoder v4l2 driver.
```

## drivers/media/platform/sunplus/vip9000/Kconfig
```kconfig
choice
	prompt "NPU Version choice"
	default v6_4_15_9
	help
	  This option sets NPU version. If in doubt, use the default version.

config v6_4_13_8
	bool "VIP9000-NPU driver v6.4.13.8"
	help
		Support for the ML Inference Processor VIP9000-NPU driver v6.4.13.8

config v6_4_15_9
	bool "VIP9000-NPU driver v6.4.15.9"
	help
		Support for the ML Inference Processor VIP9000-NPU driver v6.4.15.9

config v6_4_18_5
	bool "VIP9000-NPU driver v6.4.18.5"
	help
		Support for the ML Inference Processor VIP9000-NPU driver v6.4.18.5

endchoice
```

## drivers/mtd/spi-nor/controllers/Kconfig
```kconfig
# SPDX-License-Identifier: GPL-2.0-only
config SPI_HISI_SFC
	tristate "Hisilicon FMC SPI NOR Flash Controller(SFC)"
	depends on ARCH_HISI || COMPILE_TEST
	depends on HAS_IOMEM
	help
	  This enables support for HiSilicon FMC SPI NOR flash controller.

config SPI_NXP_SPIFI
	tristate "NXP SPI Flash Interface (SPIFI)"
	depends on OF && (ARCH_LPC18XX || COMPILE_TEST)
	depends on HAS_IOMEM
	help
	  Enable support for the NXP LPC SPI Flash Interface controller.

	  SPIFI is a specialized controller for connecting serial SPI
	  Flash. Enable this option if you have a device with a SPIFI
	  controller and want to access the Flash as a mtd device.
	  
config SPI_SUNPLUS_SPI
	tristate "Sunplus SPI NOR controller"
	depends on SOC_SP7350
	help
	  Enable the Sunplus SPI NOR controller driver. This driver
	  can be used to access the SPI NOR flash.
	  To compile this driver as a module, choose M here: the module
	  will be called sp-spi-nor.
```

## drivers/net/wireless/realtek/rtl8188eu/Kconfig
```kconfig
config RTL8188EU
	tristate "Realtek 8188EU USB WiFi"
	depends on USB
	select WIRELESS_EXT
	select WEXT_PRIV
	help
	  This is a driver for RTL8188EU based USB dognle.
```

## drivers/pinctrl/sunplus/Kconfig
```kconfig
# SPDX-License-Identifier: GPL-2.0
#
# Sunplus Pin control driver configuration
#

config PINCTRL_SPPCTL
	tristate "Sunplus SP7021 PinMux and GPIO driver"
	depends on SOC_SP7021
	depends on OF && HAS_IOMEM
	select GENERIC_PINCTRL_GROUPS
	select GENERIC_PINMUX_FUNCTIONS
	select GENERIC_PINCONF
	select PINCONF
	select PINMUX
	select GPIOLIB
	select OF_GPIO
	help
	  Say Y here to support Sunplus SP7021 pinmux controller.
	  This driver requires the pinctrl framework.
	  GPIO is provided by the same driver.
	  To compile this driver as a module, choose M here.
	  The module will be called sppinctrl.

config PINCTRL_SP7350
	bool "Sunplus SP7350 pin control and GPIO driver"
	depends on SOC_SP7350
	depends on OF && HAS_IOMEM
	select PINMUX
	select GENERIC_PINCTRL_GROUPS
	select GENERIC_PINMUX_FUNCTIONS
	select PINCONF
	select GENERIC_PINCONF
	select OF_GPIO
	select GPIOLIB
	select GPIO_SYSFS
	select GENERIC_IRQ_CHIP
	select GPIOLIB_IRQCHIP
	help
	  Say Y here to support Sunplus SP7350 pin controller.
	  The driver is selected automatically by platform.
	  This driver requires the pinctrl framework.
	  GPIO is provided by the same driver.

config PINCTRL_DEBUG
	bool "Sunplus pin control specific debug"
	depends on SOC_SP7350 && DEBUG_PINCTRL
	help
	  Say Y if you need to debug Sunplus pinmux driver in-depth.
	  Pin control driver will output more messages if you enable
	  this item. This function is dependent on DEBUG_PINCTRL. It
	  should be enabled first.
```

## drivers/soc/sunplus/Kconfig
```kconfig
#
# AXI Bus subsystem configuration
#
menu "Sunplus SoC drivers"

config SUNPLUS_AXI_MONITOR
	tristate "Sunplus AXI monitor driver"
	default n
	help
	  Sunplus breakpoint analysis of backbone-dram problem.
	  In order to speed up the breakpoint analysis of the
	  BackBone-Dram proble. Quickly locate which Master/Slave
	  caused the system to crash.

config SUNPLUS_AXI_ARBITER
	tristate "Sunplus AXI arbiter driver"
	default n
	help
	  Support issue rate limiter. Support dynamic AMBA Qos.
	  Support total data accumulation for write and read.

endmenu
```

## sound/soc/sunplus/Kconfig
```kconfig
menuconfig SND_SOC_SUNPLUS
	tristate "ASoC support for Sunplus"
	#depends on ARCH_SUNPLUS
	select SND_SOC_SPDIF
	default y
	help
	  Say Y or M if you want to add support for codecs attached to
	  the Sunplus SoCs' Audio interfaces. You will also need to
	  select the audio interfaces to support below.

config SND_SOC_AUD_SP7350
	tristate "support SP7350 codec"
	depends on SND_SOC_SUNPLUS && SOC_SP7350
	default y
```
