## arch/arm64/configs/sp7350_sdcard_dm_defconfig
```kconfig
CONFIG_LOCALVERSION="-SUNPLUS-v8"
CONFIG_LOCALVERSION_AUTO=y
CONFIG_DEFAULT_HOSTNAME="SP7350-Dm"
CONFIG_CROSS_COMPILE="aarch64-none-linux-gnu-"
CONFIG_SYSVIPC=y
# CONFIG_CROSS_MEMORY_ATTACH is not set
# CONFIG_FHANDLE is not set
CONFIG_IRQ_DOMAIN_DEBUG=y
CONFIG_POSIX_MQUEUE=y
CONFIG_USELIB=y
CONFIG_AUDIT=y
CONFIG_NO_HZ_IDLE=y
CONFIG_NUMA=y
CONFIG_HIGH_RES_TIMERS=y
CONFIG_VIRT_CPU_ACCOUNTING_GEN=y
CONFIG_BSD_PROCESS_ACCT=y
CONFIG_BSD_PROCESS_ACCT_V3=y
CONFIG_TASKSTATS=y
CONFIG_TASK_DELAY_ACCT=y
CONFIG_TASK_XACCT=y
CONFIG_TASK_IO_ACCOUNTING=y
CONFIG_LOG_BUF_SHIFT=18
CONFIG_IKCONFIG=y
CONFIG_IKCONFIG_PROC=y
CONFIG_CGROUPS=y
CONFIG_MEMCG=y
CONFIG_MEMCG_SWAP=y
# CONFIG_MEMCG_SWAP_ENABLED is not set
CONFIG_BLK_CGROUP=y
CONFIG_CGROUP_SCHED=y
CONFIG_CFS_BANDWIDTH=y
CONFIG_CGROUP_PIDS=y
CONFIG_CGROUP_RDMA=y
CONFIG_CGROUP_FREEZER=y
CONFIG_CPUSETS=y
CONFIG_CGROUP_DEVICE=y
CONFIG_CGROUP_CPUACCT=y
CONFIG_CGROUP_PERF=y
CONFIG_CGROUP_BPF=y
CONFIG_NAMESPACES=y
CONFIG_USER_NS=y
CONFIG_PERF_EVENTS=y
# CONFIG_RD_GZIP is not set
# CONFIG_RD_BZIP2 is not set
# CONFIG_RD_LZMA is not set
# CONFIG_RD_XZ is not set
# CONFIG_RD_LZO is not set
# CONFIG_RD_LZ4 is not set
CONFIG_SGETMASK_SYSCALL=y
CONFIG_SYSCTL_SYSCALL=y
CONFIG_BPF_SYSCALL=y
CONFIG_KALLSYMS_ALL=y
CONFIG_USERFAULTFD=y
CONFIG_EMBEDDED=y
# CONFIG_SLUB_DEBUG is not set
CONFIG_JUMP_LABEL=y
CONFIG_CC_STACKPROTECTOR_STRONG=y
CONFIG_BLOCK=y
CONFIG_SCSI=y
CONFIG_BLK_DEV_SD=y
CONFIG_BLK_DEV_LOOP=y
CONFIG_CHR_DEV_SG=y
CONFIG_SCHED_MC=y
CONFIG_SCHED_SMT=y
CONFIG_NR_CPUS=4
CONFIG_HOTPLUG_CPU=y
CONFIG_HZ_1000=y
CONFIG_KSM=y
CONFIG_DEFAULT_MMAP_MIN_ADDR=65536
CONFIG_TRANSPARENT_HUGEPAGE=y
CONFIG_TRANSPARENT_HUGEPAGE_MADVISE=y
CONFIG_CLEANCACHE=y
CONFIG_ZPOOL=y
CONFIG_ZBUD=y
CONFIG_ZSMALLOC=y
CONFIG_PGTABLE_MAPPING=y
CONFIG_IDLE_PAFE_TRACKING=y
CONFIG_SECCOMP=y
CONFIG_AUTO_ZRELADDR=y
CONFIG_PARAVIRT=y
# CONFIG_ARM64_VHE is not set
# CONFIG_EFI is not set
CONFIG_MODULES=y
CONFIG_MODULE_UNLOAD=y
CONFIG_MODVERSIONS=y
# CONFIG_CORE_DUMP_DEFAULT_ELF_HEADERS is not set
CONFIG_NET=y
CONFIG_PACKET=y
CONFIG_PACKET_DIAG=y
CONFIG_UNIX=y
CONFIG_INET=y
CONFIG_IP_MULTICAST=y
CONFIG_IP_PNP=y
CONFIG_IP_PNP_DHCP=y
CONFIG_IP_PNP_BOOTP=y
CONFIG_IP_PNP_RARP=y
CONFIG_NET_IPIP=m
CONFIG_BRIDGE=m
CONFIG_VLAN_8021Q=m
CONFIG_NETLINK_DIAG=y
CONFIG_BT=y
CONFIG_BT_RFCOMM=y
CONFIG_BT_RFCOMM_TTY=y
CONFIG_BT_BNEP=y
CONFIG_BT_BNEP_MC_FILTER=y
CONFIG_BT_BNEP_PROTO_FILTER=y
CONFIG_BT_HIDP=y
CONFIG_BT_HS=y
CONFIG_BT_HCIBTUSB=m
CONFIG_BT_HCIBTUSB_BCM=y
CONFIG_BT_HCIBTUSB_RTL=y
CONFIG_BT_BREDR=y
CONFIG_BT_LE=y
CONFIG_BT_INTEL=m
CONFIG_BT_BCM=y
CONFIG_BT_RTL=y
CONFIG_BT_HCIUART=y
CONFIG_BT_HCIUART_H4=y
CONFIG_CFG80211=y
CONFIG_CFG80211_WEXT=y
CONFIG_MAC80211=y
CONFIG_RFKILL=y
CONFIG_RFKILL_INPUT=y
CONFIG_CEPH_LIB=y
CONFIG_CEPH_LIB_USE_DNS_RESOLVER=y
CONFIG_UEVENT_HELPER=y
CONFIG_UEVENT_HELPER_PATH=""
CONFIG_DEVTMPFS=y
CONFIG_DEVTMPFS_MOUNT=y

#
# Firmware loader
#
CONFIG_FW_LOADER=y
CONFIG_EXTRA_FIRMWARE=""
CONFIG_FW_LOADER_USER_HELPER=y
CONFIG_FW_LOADER_USER_HELPER_FALLBACK=y
# CONFIG_FW_LOADER_COMPRESS is not set
CONFIG_FW_CACHE=y
# end of Firmware loader

CONFIG_NETDEVICES=y
# CONFIG_NET_VENDOR_ALACRITECH is not set
# CONFIG_NET_VENDOR_AMAZON is not set
# CONFIG_NET_VENDOR_AMD is not set
# CONFIG_NET_VENDOR_AQUANTIA is not set
# CONFIG_NET_VENDOR_ARC is not set
# CONFIG_NET_VENDOR_AURORA is not set
# CONFIG_NET_VENDOR_BROADCOM is not set
# CONFIG_NET_VENDOR_CADENCE is not set
# CONFIG_NET_VENDOR_CAVIUM is not set
# CONFIG_NET_VENDOR_CIRRUS is not set
# CONFIG_NET_VENDOR_CORTINA is not set
# CONFIG_NET_VENDOR_EZCHIP is not set
# CONFIG_NET_VENDOR_FARADAY is not set
# CONFIG_NET_VENDOR_GOOGLE is not set
# CONFIG_NET_VENDOR_HISILICON is not set
# CONFIG_NET_VENDOR_HUAWEI is not set
# CONFIG_NET_VENDOR_INTEL is not set
# CONFIG_NET_VENDOR_MARVELL is not set
# CONFIG_NET_VENDOR_MELLANOX is not set
# CONFIG_NET_VENDOR_MICREL is not set
# CONFIG_NET_VENDOR_MICROCHIP is not set
# CONFIG_NET_VENDOR_MICROSEMI is not set
# CONFIG_NET_VENDOR_NATSEMI is not set
# CONFIG_NET_VENDOR_NETRONOME is not set
# CONFIG_NET_VENDOR_NI is not set
# CONFIG_NET_VENDOR_PENSANDO is not set
# CONFIG_NET_VENDOR_QUALCOMM is not set
# CONFIG_NET_VENDOR_RENESAS is not set
# CONFIG_NET_VENDOR_ROCKER is not set
# CONFIG_NET_VENDOR_SAMSUNG is not set
# CONFIG_NET_VENDOR_SEEQ is not set
# CONFIG_NET_VENDOR_SOLARFLARE is not set
# CONFIG_NET_VENDOR_SMSC is not set
# CONFIG_NET_VENDOR_SOCIONEXT is not set
CONFIG_NET_VENDOR_STMICRO=y
# CONFIG_NET_VENDOR_SYNOPSYS is not set
# CONFIG_NET_VENDOR_VIA is not set
# CONFIG_NET_VENDOR_WIZNET is not set
# CONFIG_NET_VENDOR_XILINX is not set
# CONFIG_STANDALONE is not set
CONFIG_INPUT_FF_MEMLESS=y
CONFIG_RTL8723BU=m
CONFIG_RTL8188EU=m
CONFIG_USB_RTL8150=m
CONFIG_USB_RTL8152=m
CONFIG_USB_LAN78XX=m
CONFIG_USB_USBNET=m
CONFIG_INPUT_POLLDEV=y
CONFIG_INPUT_MOUSEDEV=y
CONFIG_INPUT_EVDEV=y
CONFIG_INPUT_TOUCHSCREEN=y
CONFIG_TOUCHSCREEN_PROPERTIES=y
CONFIG_TOUCHSCREEN_EDT_FT5X06=m
CONFIG_INPUT_MISC=y
CONFIG_INPUT_UINPUT=y
# CONFIG_LEGACY_PTYS is not set
CONFIG_MEDIA_SUPPORT_FILTER=y
CONFIG_MEDIA_USB_SUPPORT=y
CONFIG_USB_VIDEO_CLASS=y
CONFIG_RTC_CLASS=y
CONFIG_RTC_DRV_SUNPLUS_SP7350=y
CONFIG_SYNC_FILE=y
CONFIG_MMC=y
CONFIG_SP_EMMC=y
CONFIG_SP_SDV=y
CONFIG_SW_SYNC=y
CONFIG_PROC_KCORE=y
CONFIG_TMPFS=y
CONFIG_FUSE_FS=y
CONFIG_CONFIGFS_FS=y
CONFIG_EXT2_FS=y
CONFIG_EXT2_FS_XATTR=y
CONFIG_EXT3_FS=y
CONFIG_EXT3_FS_POSIX_ACL=y
CONFIG_EXT3_FS_SECURITY=y
CONFIG_EXT4_DEBUG=y
CONFIG_MSDOS_FS=y
CONFIG_VFAT_FS=y
CONFIG_AUTOFS_FS=y
CONFIG_FAT_DEFAULT_IOCHARSET="utf8"
CONFIG_FAT_DEFAULT_UTF8=y
CONFIG_NFS_FS=y
CONFIG_NFS_V4=y
CONFIG_ROOT_NFS=y
CONFIG_EXFAT_FS=y
CONFIG_CIFS=y
CONFIG_NLS=y
CONFIG_NLS_DEFAULT="utf8"
CONFIG_NLS_CODEPAGE_437=y
CONFIG_NLS_ASCII=y
CONFIG_NLS_ISO8859_1=y
CONFIG_NLS_UTF8=y
CONFIG_PRINTK_TIME=y
CONFIG_BOOT_PRINTK_DELAY=y
CONFIG_DYNAMIC_DEBUG=y
CONFIG_DEBUG_FS=y
CONFIG_DEBUG_INFO=y
CONFIG_DEBUG_INFO_DWARF4=y
CONFIG_GDB_SCRIPTS=y
# CONFIG_ENABLE_WARN_DEPRECATED is not set
# CONFIG_ENABLE_MUST_CHECK is not set
CONFIG_FRAME_WARN=1024
CONFIG_UNUSED_SYMBOLS=y
CONFIG_MAGIC_SYSRQ=y
CONFIG_MAIGC_SYSRQ_DEFAULT_ENABLE=0x01b6
CONFIG_LOCKUP_DETECTOR=y
CONFIG_RCU_CPU_STALL_TIMEOUT=60
CONFIG_ARM64_PTDUMP=y
#CONFIG_MALI_MIDGARD=y
CONFIG_MALI_PLATFORM_NAME="candy"
CONFIG_USB_CONFIGFS=y
CONFIG_USB_ACM=y
CONFIG_USB_SERIAL=y
CONFIG_USB_SERIAL_CP210X=y
CONFIG_USB_SERIAL_FTDI_SIO=y
CONFIG_USB_SERIAL_CH341=y
CONFIG_USB_SERIAL_OPTION=y
CONFIG_USB_SERIAL_PL2303=y
CONFIG_COMPAT=y
CONFIG_KUSER_HELPERS=y
CONFIG_ARMV8_DEPRECATED=y
CONFIG_SWP_EMULATION=y
CONFIG_CP15_BARRIER_EMULATION=y
CONFIG_SETEND_EMULATION=y
CONFIG_BINFMT_ELF=y
CONFIG_COMPAT_BINFMT_ELF=y
CONFIG_RPMSG_CHAR=y
CONFIG_RPMSG_TTY=y
CONFIG_UIO=y
CONFIG_UIO_PDRV_GENIRQ=y
CONFIG_UIO_DMEM_GENIRQ=y
CONFIG_BINFMT_SCRIPT=y
CONFIG_TEE=y
CONFIG_OPTEE=y
CONFIG_ZLIB_INFLATE=y
CONFIG_LZO_DECOMPRESS=y
CONFIG_LZ4_DECOMPRESS=y
CONFIG_ZSTD_DECOMPRESS=y
CONFIG_XZ_DEC=y
CONFIG_XZ_DEC_ARM=y
CONFIG_XZ_DEC_ARMTHUMB=y
CONFIG_DECOMPRESS_GZIP=y
CONFIG_DECOMPRESS_BZIP2=y
CONFIG_DECOMPRESS_LZMA=y
CONFIG_DECOMPRESS_XZ=y
CONFIG_DECOMPRESS_LZO=y
CONFIG_DECOMPRESS_LZ4=y
CONFIG_DECOMPRESS_ZSTD=y
#
# HID
#
CONFIG_UHID=y
CONFIG_HID_GENERIC=y
CONFIG_HID_SENSOR_HUB=y
CONFIG_HID_SENSOR_CUSTOM_SENSOR=y
CONFIG_HID_PID=y
CONFIG_HID_SENSOR_IIO_COMMON=y
CONFIG_HID_SENSOR_ACCEL_3D=y
CONFIG_HID_SENSOR_GYRO_3D=y
#
# SOC
#
CONFIG_SOC_SP7350=y
CONFIG_PM=y
CONFIG_CPU_IDLE=y
CONFIG_ARM_PSCI_CPUIDLE=y
CONFIG_CPU_FREQ=y
CONFIG_ARM_SP7350_CPUFREQ=y
CONFIG_NVMEM_SUNPLUS_SP7350_OCOTP=y
CONFIG_PINCTRL=y
CONFIG_PINCTRL_SP7350=y
CONFIG_REMOTEPROC=y
CONFIG_SUNPLUS_REMOTEPROC=y
CONFIG_WATCHDOG=y
CONFIG_SUNPLUS_WATCHDOG=y
CONFIG_HWSPINLOCK=y
CONFIG_HWSPINLOCK_SUNPLUS=y
#
# USB
#
CONFIG_USB=y
CONFIG_USB_GADGET=y
CONFIG_USB_STORAGE=y
CONFIG_USB_XHCI_HCD=y
CONFIG_USB_DWC3=y
CONFIG_SUNPLUS_SYNOPSYS_USB3_PHY=y
CONFIG_EXTCON=y
CONFIG_EXTCON_USB_GPIO_SUNPLUS=y
CONFIG_USB_EHCI_HCD=y
CONFIG_USB_EHCI_SUNPLUS=y
CONFIG_USB_OHCI_HCD=y
CONFIG_USB_OHCI_SUNPLUS=y
CONFIG_USB_SUNPLUS_OTG=y
CONFIG_USB_SP_UDC=y
CONFIG_USB_CONFIGFS=m
CONFIG_USB_CONFIGFS_SERIAL=y
CONFIG_USB_CONFIGFS_ACM=y
CONFIG_USB_CONFIGFS_OBEX=y
CONFIG_USB_CONFIGFS_NCM=y
CONFIG_USB_CONFIGFS_ECM=y
CONFIG_USB_CONFIGFS_ECM_SUBSET=y
CONFIG_USB_CONFIGFS_RNDIS=y
CONFIG_USB_CONFIGFS_EEM=y
CONFIG_USB_CONFIGFS_MASS_STORAGE=y
CONFIG_USB_CONFIGFS_F_LB_SS=y
CONFIG_USB_CONFIGFS_F_FS=y
CONFIG_USB_CONFIGFS_F_UAC1=y
CONFIG_USB_CONFIGFS_F_UAC2=y
CONFIG_USB_CONFIGFS_F_UVC=y
#
# Regulators
#
CONFIG_REGULATOR=y
CONFIG_REGULATOR_STI8070X=y
CONFIG_REGULATOR_FIXED_VOLTAGE=y
#
# DMA Devices
#
CONFIG_DMADEVICES=y
CONFIG_DW_AXI_DMAC=y
CONFIG_DMA_ENGINE=y
CONFIG_DMA_OF=y
CONFIG_DW_DMAC_CORE=y
CONFIG_DW_DMAC=y
CONFIG_CMA=y
CONFIG_DMA_CMA=y
# SPI Master Controller Drivers
# CONFIG_SPI_DEBUG is not set
CONFIG_SPI=y
CONFIG_SPI_SPIDEV=y
CONFIG_SPI_SLAVE=y
CONFIG_SPI_MASTER=y
CONFIG_SPI_MEM=y
CONFIG_SPI_DESIGNWARE=y
CONFIG_SPI_DW_DMA=y
CONFIG_SPI_DW_MMIO=y
#
# I2C support
#
CONFIG_I2C=y
CONFIG_I2C_CHARDEV=y
CONFIG_I2C_DESIGNWARE_CORE=y
CONFIG_I2C_DESIGNWARE_SLAVE=y
CONFIG_I2C_DESIGNWARE_PLATFORM=y
#
# IIO ADC support
#
CONFIG_REGMAP_IRQ=y
CONFIG_IIO=y
CONFIG_IIO_BUFFER=y
CONFIG_IIO_CONFIGFS=y
CONFIG_IIO_TRIGGER=y
CONFIG_IIO_CONSUMERS_PER_TRIGGER=2
CONFIG_IIO_SW_DEVICE=y
CONFIG_IIO_SW_TRIGGER=y
CONFIG_IIO_TRIGGERED_EVENT=y
CONFIG_SUNPLUS_ADC=y
#
# THERMAL support
#
CONFIG_THERMAL=y
CONFIG_THERMAL_EMERGENCY_POWEROFF_DELAY_MS=0
CONFIG_THERMAL_HWMON=y
CONFIG_THERMAL_OF=y
CONFIG_THERMAL_DEFAULT_GOV_STEP_WISE=y
CONFIG_THERMAL_GOV_STEP_WISE=y
CONFIG_THERMAL_EMULATION=y
CONFIG_SUNPLUS_THERMAL=y
#
# PWM
#
CONFIG_PWM=y
CONFIG_PWM_SUNPLUS=y
#
# AP6256 support
#
CONFIG_BCMDHD=y
CONFIG_BCMDHD_FW_PATH="/etc/firmware/fw_bcmdhd.bin"
CONFIG_BCMDHD_NVRAM_PATH="/etc/firmware/nvram.txt"
CONFIG_BCMDHD_SDIO=y
# CONFIG_BCMDHD_USB is not set
CONFIG_BCMDHD_OOB=y
# CONFIG_BCMDHD_SDIO_IRQ is not set

#
# STM GMAC and Reltek PHY support
#
CONFIG_PAGE_POOL=y
CONFIG_REGMAP_MMIO=y
CONFIG_MII=y
CONFIG_STMMAC_ETH=y
# CONFIG_STMMAC_SELFTESTS is not set
CONFIG_STMMAC_PLATFORM=y
# CONFIG_DWMAC_DWC_QOS_ETH is not set
CONFIG_DWMAC_GENERIC=y
# CONFIG_DWMAC_INTEL_PLAT is not set
CONFIG_PHYLINK=y
CONFIG_PHYLIB=y
CONFIG_SWPHY=y
CONFIG_FIXED_PHY=y
# CONFIG_SFP is not set
CONFIG_REALTEK_PHY=y
CONFIG_MDIO_DEVICE=y
CONFIG_MDIO_BUS=y
CONFIG_OF_MDIO=y
CONFIG_MDIO_DEVRES=y
# CONFIG_MDIO_IPQ8064 is not set
CONFIG_PCS_XPCS=y
CONFIG_MFD_SYSCON=y
CONFIG_NET_PTP_CLASSIFY=y
CONFIG_PPS=y
CONFIG_PTP_1588_CLOCK=y
#
# VIP9000 NPU support
#
CONFIG_VIP9000_NPU_DRIVERS=m
# CONFIG_v6_4_13_8 is not set
CONFIG_v6_4_15_9=y
#
# VIDEO CODEC support
#
CONFIG_VIDEO_HWCODEC_DRIVERS=y
CONFIG_VIDEO_HANTRO_DECODER=y
CONFIG_VIDEO_HANTRO_ENCODER=y
CONFIG_VIDEO_HANTRO_DECODER_MEM=y
CONFIG_VIDEO_HANTRO_ENCODER_MEM=y
CONFIG_VIDEO_HANTRO_V4L2_DECODER=y
CONFIG_VIDEO_HANTRO_V4L2_ENCODER=y
#
# AUDIO
#
CONFIG_SOUND=y
CONFIG_SND=y
CONFIG_SND_SOC=y
CONFIG_SND_HWDEP=y
CONFIG_SND_RAWMIDI=y
CONFIG_SND_USB_AUDIO=y
CONFIG_SND_USB_AUDIO_USE_MEDIA_CONTROLLER=y
CONFIG_SND_SOC_ES8316_SUNPLUS=y
#
# MIPI-RX
#
CONFIG_MEDIA_SUPPORT=y
CONFIG_MEDIA_CAMERA_SUPPORT=y
CONFIG_MEDIA_PLATFORM_SUPPORT=y
CONFIG_VIDEO_SUNPLUS_SP7350_CSI2=y
CONFIG_VIDEO_SUNPLUS_SP7350_VIN=y
CONFIG_VIDEO_IMX219=y
#
# DISPLAY
#
CONFIG_DRM=y
CONFIG_DRM_MIPI_DSI=y
CONFIG_DRM_KMS_HELPER=y
CONFIG_DRM_KMS_FB_HELPER=y
CONFIG_DRM_FBDEV_EMULATION=y
CONFIG_DRM_FBDEV_OVERALLOC=100
CONFIG_DRM_LOAD_EDID_FIRMWARE=y
CONFIG_DRM_GEM_DMA_HELPER=y
CONFIG_DRM_KMS_DMA_HELPER=y
CONFIG_DRM_PANEL=y
CONFIG_DRM_PANEL_RASPBERRYPI_TOUCHSCREEN=y
CONFIG_DRM_BRIDGE=y
CONFIG_DRM_PANEL_BRIDGE=y
CONFIG_DRM_DISPLAY_CONNECTOR=y
CONFIG_DRM_LONTIUM_LT8912B=y
CONFIG_DRM_SP7350=y
CONFIG_DRM_PANEL_SP7350_SIMPLE_DSI=y
CONFIG_DRM_PANEL_ORIENTATION_QUIRKS=y
CONFIG_VIDEOMODE_HELPERS=y
CONFIG_HDMI=y

CONFIG_FB=y
# CONFIG_VIDEO_SP7350_DISP is not set
# CONFIG_FB_SP7350 is not set
CONFIG_FRAMEBUFFER_CONSOLE=y
# CONFIG_FRAMEBUFFER_CONSOLE_DEFERRED_TAKEOVER is not set
#
# LONTIUM_LT8912B BRIDGE
#
# CONFIG_VIDEO_SP7350_DISP_LT8912B is not set
#
# CRYPTO
#
CONFIG_CRYPTO_DEV_SP=y
#
# Running LED
#
CONFIG_NEW_LEDS=y
CONFIG_LEDS_CLASS=y
CONFIG_LEDS_GPIO=y
CONFIG_LEDS_TRIGGERS=y
CONFIG_LEDS_TRIGGER_HEARTBEAT=y

# for VPN:L2TP
CONFIG_CRYPTO_XTS=y
CONFIG_XFRM_USER=y
CONFIG_IP_ADVANCED_ROUTER=y
CONFIG_IP_MULTIPLE_TABLES=y
CONFIG_INET_AH=y
CONFIG_INET_ESP=y
CONFIG_INET_IPCOMP=y
CONFIG_INET6_AH=y
CONFIG_INET6_ESP=y
CONFIG_INET6_IPCOMP=y
CONFIG_IPV6_MULTIPLE_TABLES=y
CONFIG_NETFILTER=y
CONFIG_NETFILTER_XTABLES=y
# CONFIG_NETFILTER_XT_MATCH_L2TP is not set
CONFIG_NETFILTER_XT_MATCH_POLICY=y
CONFIG_L2TP=y
CONFIG_L2TP_DEBUGFS=y
CONFIG_L2TP_V3=y
CONFIG_L2TP_IP=y
CONFIG_L2TP_ETH=y
CONFIG_PPP=y
CONFIG_PPP_BSDCOMP=y
CONFIG_PPP_DEFLATE=y
CONFIG_PPP_FILTER=y
CONFIG_PPP_MPPE=y
CONFIG_PPP_MULTILINK=y
CONFIG_PPPOE=y
CONFIG_PPPOL2TP=y
CONFIG_PPP_ASYNC=y
CONFIG_PPP_SYNC_TTY=y
#
# ADC KEY
#
CONFIG_KEYBOARD_ADC=y
```

## drivers/gpu/drm/sunplus/sp7350/Kconfig
```kconfig
# SPDX-License-Identifier: GPL-2.0
#
# sunplus drm device configuration.

config DRM_SP7350
	tristate "DRM Support for SUNPLUS SP7350"
	depends on DRM
	depends on VIDEO_DEV && SOC_SP7350
	select DRM_MIPI_DSI
	select DRM_KMS_HELPER
	select DRM_KMS_DMA_HELPER
	select DRM_GEM_DMA_HELPER
	default y
	help
	   This option enables support for the Sunplus SP7350 SoCs with a
	   Display Engine.
	   This driver is necessary for drm framework that wishes to utilize the
	   SoCs Hardware Display for its intended purposes. Without this driver,
	   the device will not be recognized or accessible by the system.
	   Please note that this driver requires the SOC_SP7350 and VIDEO_DEV
	   to be enabled as well, as it depends on certain functionality
	   provided by that option.

config DRM_PANEL_SP7350_SIMPLE_DSI
	tristate "support for sunplus simple dsi panels"
	depends on OF
	depends on DRM_SP7350
	select VIDEOMODE_HELPERS
	default y
	help
	  DRM panel driver for dumb panels that need at most a regulator and
	  a GPIO to be powered up. Optionally a backlight can be attached so
	  that it can be automatically turned off when the panel goes into a
	  low power state.
```

## drivers/iio/imu/bmi088/Kconfig
```kconfig
# SPDX-License-Identifier: GPL-2.0-only
#
# BMI088 IMU driver
#

config BMI088
	tristate
	select IIO_BUFFER
	select IIO_TRIGGERED_BUFFER

config BMI088_I2C
	tristate "Bosch BMI088 I2C driver"
	depends on I2C
	select BMI088
	select REGMAP_I2C
	help
	  If you say yes here you get support for BMI088 IMU on I2C with
	  accelerometer, gyroscope and external BMG088 magnetometer.

	  This driver can also be built as a module. If so, the module will be
	  called bmi088_i2c.

config BMI088_SPI
	tristate "Bosch BMI088 SPI driver"
	depends on SPI
	select BMI088
	select REGMAP_SPI
	help
	  If you say yes here you get support for BMI088 IMU on SPI with
	  accelerometer, gyroscope and external BMG088 magnetometer.

	  This driver can also be built as a module. If so, the module will be
	  called bmi088_spi.
```

## drivers/media/i2c/vd55flood/Kconfig
```kconfig
config VIDEO_VD55FLOOD
	tristate "ST VD55Flood ToF Camera Sensor Driver Support"
	select V4L2_CCI_I2C
	help
	  Support for ST VD55Flood ToF Camera Sensor Driver.

	  To compile this driver as a module, choose M here: the
	  module will be called vd55flood.
```

## drivers/media/platform/sunplus/Kconfig
```kconfig
# SPDX-License-Identifier: GPL-2.0

comment "Sunplus media platform drivers"

source "drivers/media/platform/sunplus/display/sp7350/Kconfig"
source "drivers/media/platform/sunplus/gdc/Kconfig"
source "drivers/media/platform/sunplus/stereo/Kconfig"
source "drivers/media/platform/sunplus/tsp/Kconfig"
source "drivers/media/platform/sunplus/isp/Kconfig"
source "drivers/media/platform/sunplus/mipicsi/Kconfig"
```
